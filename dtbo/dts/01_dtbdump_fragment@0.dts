/dts-v1/;

/ {

	fragment@0 {
		target = <0xffffffff>;

		__overlay__ {
			bootargs_ext = [00];
		};
	};

	fragment@1 {
		target = <0xffffffff>;

		__overlay__ {

			thermal-message {
				board-sensor = "VIRTUAL-SENSOR";
				phandle = <0x72>;
			};
		};
	};

	fragment@2 {
		target = <0xffffffff>;

		__overlay__ {
			pd-vbus-upper-bound = <0x895440>;
		};
	};

	fragment@3 {
		target = <0xffffffff>;

		__overlay__ {
			clock-frequency = <0x61a80>;

			aw882xx@35 {
				compatible = "awinic,aw882xx_smartpa";
				#sound-dai-cells = <0x00>;
				reg = <0x35>;
				reset-gpio = <0xffffffff 0xc1 0x00>;
				irq-gpio = <0xffffffff 0x11 0x00>;
				fsm,rst-gpio = <0xffffffff 0xc1 0x00>;
				fsm,irq-gpio = <0xffffffff 0x11 0x00>;
				sync-load = <0x01>;
				vcalb_half = <0x01>;
				sound-channel = <0x00>;
				aw-re-min = <0x157c>;
				aw-re-max = <0x251c>;
				status = "okay";
				phandle = <0x04>;
			};

			aw882xx@34 {
				compatible = "awinic,aw882xx_smartpa";
				#sound-dai-cells = <0x00>;
				reg = <0x34>;
				reset-gpio = <0xffffffff 0xc0 0x00>;
				irq-gpio = <0xffffffff 0x0a 0x00>;
				fsm,rst-gpio = <0xffffffff 0xc0 0x00>;
				fsm,irq-gpio = <0xffffffff 0x0a 0x00>;
				sync-load = <0x01>;
				vcalb_half = <0x01>;
				sound-channel = <0x01>;
				aw-re-min = <0x157c>;
				aw-re-max = <0x251c>;
				status = "okay";
				phandle = <0x05>;
			};

			sia91xx_i2c@R {
				compatible = "si,sia91xx-i2c";
				#sound-dai-cells = <0x00>;
				reg = <0x6c>;
				si,sipa-dev = <0x01>;
				status = "okay";
				phandle = <0x07>;
			};

			sia91xx_i2c@L {
				compatible = "si,sia91xx-i2c";
				#sound-dai-cells = <0x00>;
				reg = <0x6d>;
				si,sipa-dev = <0x02>;
				status = "okay";
				phandle = <0x06>;
			};

			et7480@42 {
				status = "ok";
				compatible = "mediatek,et7480-audioswitch";
				reg = <0x42>;
				phandle = <0x03>;
			};
		};
	};

	fragment@4 {
		target = <0xffffffff>;

		__overlay__ {
			et7480-i2c-handle = <0x03>;
		};
	};

	fragment@5 {
		target = <0xffffffff>;

		__overlay__ {
			mediatek,spk-i2s = <0x19 0x18>;

			mediatek,speaker-codec {
				sound-dai = <0x04 0x05>;
			};

			mediatek,speaker-codec-fsm {
				sound-dai = <0x04>;
			};

			mediatek,speaker-codec-sia {
				sound-dai = <0x06 0x07>;
			};
		};
	};

	fragment@6 {
		target = <0xffffffff>;

		__overlay__ {

			sia91xx@R {
				compatible = "si,sia91xx";
				si,si_pa_type = "sia9187";
				si,si_pa_irq = <0xffffffff 0x11 0x00>;
				si,si_pa_reset = <0xffffffff 0xc1 0x00>;
				pinctrl-names = "si_pa_gpio";
				pinctrl-0 = <0x08>;
				si,si_pa_disable_pin = <0x00>;
				channel_num = <0x01>;
				phandle = <0x01>;
			};

			sia91xx@L {
				compatible = "si,sia91xx";
				si,si_pa_type = "sia9187";
				si,si_pa_irq = <0xffffffff 0x0a 0x00>;
				si,si_pa_reset = <0xffffffff 0xc0 0x00>;
				pinctrl-names = "si_pa_gpio";
				pinctrl-0 = <0x09>;
				si,si_pa_disable_pin = <0x00>;
				channel_num = <0x00>;
				phandle = <0x02>;
			};
		};
	};

	fragment@7 {
		target = <0xffffffff>;

		__overlay__ {
			si,sia81xx-max-num = <0x02>;
			si,is_digital_pa = <0x01>;
			si,sia81xx-aux-devs = <0x06 0x07>;
			si,sia81xx-aux-devs-prefix = "SpkrLeft", "SpkrRight";
		};
	};

	fragment@8 {
		target = <0xffffffff>;

		__overlay__ {

			sia91xx_gpio_R {
				phandle = <0x08>;

				pins_cmd_dat {
					pinmux = <0xc100>;
					slew-rate = <0x01>;
					bias-disable;
				};
			};

			sia91xx_gpio_L {
				phandle = <0x09>;

				pins_cmd_dat {
					pinmux = <0xc000>;
					slew-rate = <0x01>;
					bias-disable;
				};
			};
		};
	};

	fragment@9 {
		target = <0xffffffff>;

		__overlay__ {
			pinctrl-names = "lcd_bias_enp1_gpio", "lcd_bias_enp0_gpio", "lcd_bias_enn1_gpio", "lcd_bias_enn0_gpio", "lcm_rst_out1_gpio", "lcm_rst_out0_gpio", "mode_te_te", "lcm_led_en1_gpio", "lcm_led_en0_gpio";
			pinctrl-0 = <0x0a>;
			pinctrl-1 = <0x0b>;
			pinctrl-2 = <0x0c>;
			pinctrl-3 = <0x0d>;
			pinctrl-4 = <0x0e>;
			pinctrl-5 = <0x0f>;
			pinctrl-6 = <0x10>;
			pinctrl-7 = <0x11>;
			pinctrl-8 = <0x12>;
			status = "okay";
		};
	};

	fragment@10 {
		target = <0xffffffff>;

		__overlay__ {

			lcd-bias-enp1-gpio {
				phandle = <0x0a>;

				pins-cmd-dat {
					pinmux = <0x9500>;
					slew-rate = <0x01>;
					output-high;
				};
			};

			lcd-bias-enp0-gpio {
				phandle = <0x0b>;

				pins-cmd-dat {
					pinmux = <0x9500>;
					slew-rate = <0x01>;
					output-low;
				};
			};

			lcd-bias-enn1-gpio {
				phandle = <0x0c>;

				pins-cmd-dat {
					pinmux = <0x9500>;
					slew-rate = <0x01>;
					output-high;
				};
			};

			lcd-bias-enn0-gpio {
				phandle = <0x0d>;

				pins-cmd-dat {
					pinmux = <0x9500>;
					slew-rate = <0x01>;
					output-low;
				};
			};

			lcm-rst-out1-gpio {
				phandle = <0x0e>;

				pins-cmd-dat {
					pinmux = <0x5a00>;
					slew-rate = <0x01>;
					output-high;
				};
			};

			lcm-rst-out0-gpio {
				phandle = <0x0f>;

				pins-cmd-dat {
					pinmux = <0x5a00>;
					slew-rate = <0x01>;
					output-low;
				};
			};

			lcm-dsi-te {
				phandle = <0x10>;

				pins-cmd-dat {
					pinmux = <0x5901>;
				};
			};

			lcm-led-en1-gpio {
				phandle = <0x11>;

				pins-cmd-dat {
					pinmux = <0x9500>;
					slew-rate = <0x01>;
					output-high;
				};
			};

			lcm-led-en0-gpio {
				phandle = <0x12>;

				pins-cmd-dat {
					pinmux = <0x9500>;
					slew-rate = <0x01>;
					output-low;
				};
			};
		};
	};

	fragment@11 {
		target = <0xffffffff>;

		__overlay__ {
			pinctrl-names = "mode_te_te";
			pinctrl-0 = <0x10>;
			status = "okay";
		};
	};

	fragment@12 {
		target = <0xffffffff>;

		__overlay__ {
			status = "okay";
			#address-cells = <0x01>;
			#size-cells = <0x00>;

			panel1@0 {
				compatible = "o16u_42_02_0a_dsc_vdo,lcm";
				reg = <0x00>;
				reset-gpios = <0xffffffff 0x5a 0x00>;
				dvdd-gpios = <0xffffffff 0xb8 0x00>;
				amoled-vci-supply = <0xffffffff>;
				amoled-vio18-supply = <0xffffffff>;
				res-switch = <0x02>;
				rc-enable = <0x01>;
				pinctrl-names = "default";

				port {

					endpoint {
						remote-endpoint = <0x13>;
						phandle = <0x18>;
					};
				};
			};

			panel2@1 {
				compatible = "o16u_36_02_0b_dsc_vdo,lcm";
				reg = <0x01>;
				reset-gpios = <0xffffffff 0x5a 0x00>;
				dvdd-gpios = <0xffffffff 0xb8 0x00>;
				amoled-vci-supply = <0xffffffff>;
				amoled-vio18-supply = <0xffffffff>;
				res-switch = <0x02>;
				rc-enable = <0x01>;
				pinctrl-names = "default";

				port {

					endpoint {
						remote-endpoint = <0x14>;
						phandle = <0x19>;
					};
				};
			};

			panel3@2 {
				compatible = "o16u_44_0f_0c_dsc_vdo,lcm";
				reg = <0x02>;
				reset-gpios = <0xffffffff 0x5a 0x00>;
				dvdd-gpios = <0xffffffff 0xb8 0x00>;
				amoled-vci-supply = <0xffffffff>;
				amoled-vio18-supply = <0xffffffff>;
				res-switch = <0x02>;
				rc-enable = <0x01>;
				pinctrl-names = "default";

				port {

					endpoint {
						remote-endpoint = <0x15>;
						phandle = <0x1a>;
					};
				};
			};

			panel4@3 {
				compatible = "o16u_42_02_0d_dsc_vdo,lcm";
				reg = <0x03>;
				reset-gpios = <0xffffffff 0x5a 0x00>;
				dvdd-gpios = <0xffffffff 0xb8 0x00>;
				amoled-vci-supply = <0xffffffff>;
				amoled-vio18-supply = <0xffffffff>;
				res-switch = <0x02>;
				rc-enable = <0x01>;
				pinctrl-names = "default";

				port {

					endpoint {
						remote-endpoint = <0x16>;
						phandle = <0x1b>;
					};
				};
			};

			panel5@4 {
				compatible = "o16u_virtual_default_dsc_vdo,lcm";
				reg = <0x04>;
				reset-gpios = <0xffffffff 0x5a 0x00>;
				dvdd-gpios = <0xffffffff 0xb8 0x00>;
				amoled-vci-supply = <0xffffffff>;
				amoled-vio18-supply = <0xffffffff>;
				res-switch = <0x02>;
				rc-enable = <0x01>;
				pinctrl-names = "default";

				port {

					endpoint {
						remote-endpoint = <0x17>;
						phandle = <0x1c>;
					};
				};
			};

			ports {

				port {

					endpoint {
						remote-endpoint = <0x18>;
						phandle = <0x13>;
					};

					endpoint2 {
						remote-endpoint = <0x19>;
						phandle = <0x14>;
					};

					endpoint3 {
						remote-endpoint = <0x1a>;
						phandle = <0x15>;
					};

					endpoint4 {
						remote-endpoint = <0x1b>;
						phandle = <0x16>;
					};

					endpoint5 {
						remote-endpoint = <0x1c>;
						phandle = <0x17>;
					};
				};
			};
		};
	};

	fragment@13 {
		target = <0xffffffff>;

		__overlay__ {
			pwm_ch = <0x00>;
			pinctrl-names = "irtx_gpio_led_default", "irtx_gpio_led_set";
			pinctrl-0 = <0x1d>;
			pinctrl-1 = <0x1e>;
			status = "okay";
		};
	};

	fragment@14 {
		target = <0xffffffff>;

		__overlay__ {

			irtx_gpio_led_def@gpio19 {
				phandle = <0x1d>;

				pins_cmd_dat {
					pinmux = <0x1300>;
					slew-rate = <0x01>;
					bias-disable;
					output-low;
					input-schmitt-enable = <0x00>;
				};
			};

			irtx_gpio_led_set@gpio19 {
				phandle = <0x1e>;

				pins_cmd_dat {
					pinmux = <0x1301>;
					slew-rate = <0x01>;
					output-high;
				};
			};
		};
	};

	fragment@15 {
		target = <0xffffffff>;

		__overlay__ {
			reg = <0x00 0x11059000 0x00 0xc000>;
			mode-size = <0xc000 0x11300>;
		};
	};

	fragment@16 {
		target = <0xffffffff>;

		__overlay__ {
			reg = <0x00 0x11065000 0x00 0x3900>;
			mode-size = <0x3900>;
			afe-reserved;
		};
	};

	fragment@17 {
		target = <0xffffffff>;

		__overlay__ {

			MTEE {
				compatible = "mediatek,mtk_svp_on_mtee_support";
				phandle = <0x73>;
			};

			SecureVideoPath {
				compatible = "mediatek,mtk_sec_video_path_support";
				phandle = <0x74>;
			};
		};
	};

	fragment@18 {
		target = <0xffffffff>;

		__overlay__ {
			status = "ok";
		};
	};

	fragment@19 {
		target = <0xffffffff>;

		__overlay__ {
			status = "ok";
		};
	};

	fragment@20 {
		target = <0xffffffff>;

		__overlay__ {
			status = "ok";
		};
	};

	fragment@21 {
		target = <0xffffffff>;

		__overlay__ {
			status = "ok";
		};
	};

	fragment@22 {
		target = <0xffffffff>;

		__overlay__ {
			GPIO-FDD-BAND-SUPPORT-DETECT-1ST-PIN = <0xffffffff 0x1e 0x00>;
			GPIO-SIM1-HOT-PLUG = <0xffffffff 0x2e 0x00>;
			GPIO-SIM2-HOT-PLUG = <0xffffffff 0x2f 0x00>;
			GPIO-SIM1-SCLK = <0xffffffff 0x53 0x00>;
			GPIO-SIM1-SRST = <0xffffffff 0x54 0x00>;
			GPIO-SIM1-SIO = <0xffffffff 0x55 0x00>;
			GPIO-SIM2-SCLK = <0xffffffff 0x56 0x00>;
			GPIO-SIM2-SRST = <0xffffffff 0x57 0x00>;
			GPIO-SIM2-SIO = <0xffffffff 0x58 0x00>;
		};
	};

	fragment@23 {
		target = <0xffffffff>;

		__overlay__ {
			gpio-init-default = <0x00 0x00 0x00 0x00 0x01 0x00 0x01 0x01 0x00 0x00 0x00 0x01 0x00 0x01 0x02 0x00 0x00 0x00 0x01 0x00 0x01 0x03 0x00 0x00 0x00 0x01 0x00 0x01 0x04 0x00 0x00 0x00 0x01 0x00 0x01 0x05 0x06 0x00 0x00 0x01 0x00 0x01 0x06 0x00 0x00 0x00 0x00 0x00 0x01 0x07 0x00 0x00 0x00 0x01 0x01 0x01 0x08 0x06 0x00 0x00 0x01 0x00 0x01 0x09 0x06 0x00 0x00 0x01 0x00 0x01 0x0a 0x00 0x00 0x00 0x01 0x01 0x01 0x0b 0x06 0x00 0x00 0x01 0x00 0x01 0x0c 0x06 0x00 0x00 0x00 0x00 0x01 0x0d 0x00 0x00 0x00 0x01 0x01 0x01 0x0e 0x00 0x00 0x00 0x01 0x01 0x01 0x0f 0x00 0x00 0x00 0x01 0x01 0x01 0x10 0x00 0x00 0x00 0x01 0x00 0x01 0x11 0x00 0x00 0x00 0x01 0x01 0x01 0x12 0x00 0x00 0x00 0x01 0x00 0x01 0x13 0x01 0x00 0x00 0x01 0x00 0x01 0x14 0x00 0x00 0x00 0x01 0x01 0x01 0x15 0x00 0x01 0x00 0x01 0x00 0x01 0x16 0x00 0x01 0x00 0x01 0x00 0x01 0x17 0x00 0x01 0x00 0x01 0x00 0x01 0x18 0x00 0x01 0x00 0x01 0x00 0x01 0x19 0x00 0x01 0x00 0x01 0x00 0x01 0x1a 0x00 0x01 0x00 0x01 0x00 0x01 0x1b 0x00 0x01 0x00 0x01 0x00 0x01 0x1c 0x00 0x01 0x00 0x01 0x00 0x01 0x1d 0x03 0x00 0x00 0x00 0x00 0x01 0x1e 0x00 0x00 0x00 0x01 0x00 0x00 0x1f 0x03 0x00 0x00 0x00 0x00 0x01 0x20 0x03 0x00 0x00 0x01 0x01 0x01 0x21 0x00 0x00 0x00 0x01 0x00 0x00 0x22 0x00 0x00 0x00 0x01 0x00 0x00 0x23 0x00 0x00 0x00 0x01 0x00 0x00 0x24 0x00 0x00 0x00 0x00 0x00 0x01 0x25 0x00 0x00 0x00 0x01 0x00 0x00 0x26 0x00 0x00 0x00 0x01 0x00 0x00 0x27 0x00 0x01 0x00 0x01 0x00 0x00 0x28 0x00 0x01 0x01 0x01 0x00 0x01 0x29 0x00 0x00 0x00 0x01 0x00 0x01 0x2a 0x02 0x00 0x00 0x00 0x00 0x01 0x2b 0x02 0x00 0x00 0x00 0x00 0x01 0x2c 0x02 0x00 0x00 0x01 0x00 0x01 0x2d 0x02 0x00 0x00 0x00 0x00 0x01 0x2e 0x01 0x00 0x00 0x01 0x01 0x01 0x2f 0x01 0x00 0x00 0x01 0x01 0x01 0x30 0x01 0x00 0x00 0x00 0x00 0x01 0x31 0x01 0x00 0x00 0x01 0x01 0x01 0x32 0x07 0x00 0x00 0x00 0x00 0x01 0x33 0x07 0x00 0x00 0x01 0x01 0x01 0x34 0x03 0x00 0x00 0x01 0x00 0x01 0x35 0x03 0x00 0x00 0x01 0x00 0x01 0x36 0x01 0x00 0x00 0x01 0x01 0x01 0x37 0x07 0x00 0x00 0x01 0x00 0x01 0x38 0x07 0x00 0x00 0x01 0x00 0x01 0x39 0x00 0x01 0x00 0x01 0x00 0x01 0x3a 0x07 0x00 0x00 0x00 0x00 0x01 0x3b 0x07 0x00 0x00 0x01 0x00 0x01 0x3c 0x01 0x00 0x00 0x01 0x00 0x01 0x3d 0x01 0x00 0x00 0x01 0x01 0x01 0x3e 0x01 0x00 0x00 0x01 0x00 0x01 0x3f 0x01 0x00 0x00 0x01 0x00 0x01 0x40 0x01 0x00 0x00 0x01 0x00 0x01 0x41 0x01 0x00 0x00 0x01 0x01 0x01 0x42 0x01 0x00 0x00 0x01 0x00 0x01 0x43 0x01 0x00 0x00 0x01 0x00 0x01 0x44 0x02 0x00 0x00 0x01 0x00 0x01 0x45 0x02 0x00 0x00 0x01 0x01 0x01 0x46 0x02 0x00 0x00 0x01 0x00 0x01 0x47 0x02 0x00 0x00 0x01 0x00 0x01 0x48 0x01 0x00 0x00 0x01 0x00 0x01 0x49 0x01 0x00 0x00 0x01 0x01 0x01 0x4a 0x01 0x00 0x00 0x01 0x00 0x01 0x4b 0x01 0x00 0x00 0x01 0x00 0x01 0x4d 0x00 0x00 0x00 0x00 0x00 0x01 0x4e 0x00 0x00 0x00 0x00 0x00 0x01 0x4f 0x00 0x01 0x00 0x01 0x01 0x01 0x50 0x00 0x01 0x00 0x01 0x01 0x01 0x51 0x00 0x01 0x00 0x01 0x00 0x01 0x52 0x00 0x00 0x00 0x00 0x00 0x01 0x53 0x01 0x00 0x00 0x00 0x00 0x01 0x54 0x01 0x00 0x00 0x00 0x00 0x01 0x55 0x01 0x00 0x00 0x01 0x01 0x01 0x56 0x01 0x00 0x00 0x00 0x00 0x01 0x57 0x01 0x00 0x00 0x00 0x00 0x01 0x58 0x01 0x00 0x00 0x01 0x01 0x01 0x59 0x01 0x00 0x00 0x01 0x00 0x01 0x5a 0x01 0x00 0x00 0x01 0x00 0x01 0x5b 0x01 0x00 0x00 0x01 0x00 0x01 0x5c 0x00 0x00 0x00 0x01 0x00 0x01 0x5d 0x01 0x00 0x00 0x01 0x00 0x01 0x5e 0x01 0x00 0x00 0x01 0x00 0x01 0x5f 0x01 0x00 0x00 0x01 0x00 0x01 0x60 0x01 0x00 0x00 0x01 0x00 0x01 0x61 0x01 0x00 0x00 0x01 0x00 0x01 0x62 0x01 0x00 0x00 0x01 0x00 0x01 0x63 0x01 0x00 0x00 0x00 0x00 0x01 0x64 0x01 0x00 0x00 0x00 0x00 0x01 0x65 0x01 0x00 0x00 0x00 0x00 0x01 0x66 0x01 0x00 0x00 0x00 0x00 0x01 0x67 0x01 0x00 0x00 0x00 0x00 0x01 0x68 0x01 0x00 0x00 0x00 0x00 0x01 0x69 0x01 0x00 0x00 0x00 0x00 0x01 0x6a 0x01 0x00 0x00 0x00 0x00 0x01 0x6b 0x01 0x00 0x00 0x00 0x00 0x01 0x6c 0x01 0x00 0x00 0x00 0x00 0x01 0x6d 0x01 0x00 0x00 0x00 0x00 0x01 0x6e 0x01 0x00 0x00 0x00 0x00 0x01 0x6f 0x01 0x00 0x00 0x00 0x00 0x01 0x70 0x01 0x00 0x00 0x00 0x00 0x01 0x71 0x01 0x00 0x00 0x00 0x00 0x01 0x72 0x01 0x00 0x00 0x00 0x00 0x01 0x73 0x00 0x00 0x00 0x01 0x00 0x01 0x74 0x00 0x00 0x00 0x01 0x00 0x01 0x75 0x01 0x00 0x00 0x00 0x00 0x00 0x76 0x01 0x00 0x00 0x01 0x00 0x00 0x77 0x01 0x00 0x00 0x00 0x00 0x00 0x78 0x01 0x00 0x00 0x01 0x00 0x00 0x79 0x01 0x00 0x00 0x00 0x00 0x00 0x7a 0x01 0x00 0x00 0x01 0x00 0x00 0x7b 0x01 0x00 0x00 0x01 0x00 0x01 0x7c 0x01 0x00 0x00 0x01 0x00 0x01 0x7d 0x02 0x00 0x00 0x01 0x01 0x01 0x7e 0x02 0x00 0x00 0x01 0x01 0x01 0x7f 0x02 0x00 0x00 0x01 0x01 0x01 0x80 0x02 0x00 0x00 0x01 0x01 0x01 0x81 0x01 0x00 0x00 0x01 0x01 0x01 0x82 0x01 0x00 0x00 0x01 0x01 0x01 0x83 0x01 0x00 0x00 0x01 0x01 0x01 0x84 0x01 0x00 0x00 0x01 0x01 0x01 0x85 0x01 0x00 0x00 0x01 0x01 0x01 0x86 0x01 0x00 0x00 0x01 0x01 0x01 0x87 0x01 0x00 0x00 0x01 0x01 0x01 0x88 0x01 0x00 0x00 0x01 0x01 0x01 0x89 0x01 0x00 0x00 0x01 0x01 0x01 0x8a 0x01 0x00 0x00 0x01 0x01 0x01 0x8b 0x01 0x00 0x00 0x01 0x01 0x01 0x8c 0x01 0x00 0x00 0x01 0x01 0x01 0x8d 0x01 0x00 0x00 0x01 0x01 0x01 0x8e 0x01 0x00 0x00 0x01 0x01 0x01 0x8f 0x02 0x01 0x00 0x01 0x00 0x01 0x90 0x02 0x01 0x00 0x01 0x00 0x01 0x91 0x02 0x00 0x00 0x01 0x01 0x01 0x92 0x02 0x00 0x00 0x01 0x01 0x01 0x93 0x02 0x00 0x00 0x01 0x01 0x01 0x94 0x02 0x00 0x00 0x01 0x01 0x01 0x95 0x00 0x01 0x00 0x01 0x00 0x01 0x96 0x00 0x01 0x00 0x01 0x00 0x01 0x97 0x01 0x00 0x00 0x01 0x00 0x01 0x98 0x00 0x00 0x00 0x01 0x00 0x01 0x99 0x00 0x01 0x00 0x01 0x00 0x01 0x9a 0x00 0x01 0x00 0x01 0x00 0x01 0x9b 0x00 0x01 0x00 0x01 0x00 0x01 0x9c 0x01 0x00 0x00 0x00 0x00 0x01 0x9d 0x01 0x00 0x00 0x00 0x00 0x01 0x9e 0x01 0x00 0x00 0x00 0x00 0x01 0x9f 0x01 0x00 0x00 0x00 0x00 0x01 0xa0 0x01 0x00 0x00 0x00 0x00 0x01 0xa1 0x01 0x00 0x00 0x00 0x00 0x01 0xa2 0x01 0x00 0x00 0x01 0x00 0x01 0xa3 0x01 0x00 0x00 0x00 0x00 0x01 0xa4 0x01 0x00 0x00 0x00 0x00 0x01 0xa5 0x01 0x00 0x00 0x01 0x00 0x01 0xa6 0x01 0x00 0x00 0x00 0x00 0x01 0xa7 0x01 0x00 0x00 0x00 0x00 0x01 0xa8 0x01 0x00 0x00 0x00 0x00 0x01 0xa9 0x01 0x00 0x00 0x00 0x00 0x01 0xaa 0x01 0x00 0x00 0x01 0x00 0x01 0xab 0x01 0x00 0x00 0x01 0x00 0x01 0xac 0x00 0x00 0x00 0x01 0x00 0x01 0xad 0x00 0x00 0x00 0x01 0x00 0x01 0xae 0x00 0x00 0x00 0x01 0x00 0x01 0xaf 0x00 0x00 0x00 0x01 0x00 0x01 0xb0 0x00 0x00 0x00 0x01 0x00 0x01 0xb1 0x00 0x00 0x00 0x01 0x00 0x01 0xb2 0x00 0x00 0x00 0x01 0x00 0x01 0xb3 0x00 0x00 0x00 0x01 0x00 0x01 0xb4 0x00 0x00 0x00 0x01 0x00 0x01 0xb5 0x00 0x00 0x00 0x01 0x00 0x01 0xb6 0x00 0x00 0x00 0x01 0x00 0x01 0xb7 0x01 0x00 0x00 0x01 0x00 0x01 0xb8 0x00 0x01 0x00 0x01 0x00 0x01 0xbc 0x00 0x01 0x00 0x01 0x00 0x01 0xc0 0x00 0x01 0x01 0x01 0x00 0x01 0xc1 0x00 0x01 0x01 0x01 0x00 0x01>;
		};
	};

	fragment@24 {
		target = <0xffffffff>;

		__overlay__ {
			interrupt-parent = <0xffffffff>;
			interrupts = <0x02 0x04>;
			status = "okay";
		};
	};

	fragment@25 {
		target = <0xffffffff>;

		__overlay__ {
			interrupt-parent = <0xffffffff>;
			interrupts = <0x07 0x08>;
			status = "okay";
		};
	};

	fragment@26 {
		target = <0xffffffff>;

		__overlay__ {
			interrupt-parent = <0xffffffff>;
			interrupts = <0x0d 0x08>;
			deb-gpios = <0xffffffff 0x0d 0x00>;
			debounce = <0x7d000>;
			status = "okay";
		};
	};

	fragment@27 {
		target = <0xffffffff>;

		__overlay__ {
			interrupt-parent = <0xffffffff>;
			interrupts = <0x0f 0x08>;
			status = "okay";
		};
	};

	fragment@28 {
		target = <0xffffffff>;

		__overlay__ {
			interrupt-parent = <0xffffffff>;
			interrupts = <0x13 0x02>;
			status = "okay";
		};
	};

	fragment@29 {
		target = <0xffffffff>;

		__overlay__ {
			interrupt-parent = <0xffffffff>;
			interrupts = <0x14 0x08>;
			deb-gpios = <0xffffffff 0x14 0x00>;
			debounce = <0x3e800>;
			status = "okay";
		};
	};

	fragment@30 {
		target = <0xffffffff>;

		__overlay__ {
			interrupt-parent = <0xffffffff>;
			interrupts = <0x29 0x08>;
			status = "okay";
		};
	};

	fragment@31 {
		target = <0xffffffff>;

		__overlay__ {
			interrupt-parent = <0xffffffff>;
			interrupts = <0x59 0x01>;
			status = "okay";
		};
	};

	fragment@32 {
		target = <0xffffffff>;

		__overlay__ {
			compatible = "mediatek,md1_sim1_hot_plug_eint-eint";
			interrupt-parent = <0xffffffff>;
			interrupts = <0x00 0x08>;
			debounce = <0x00 0x2710>;
			dedicated = <0x00 0x00>;
			src-pin = <0x00 0x01>;
			sockettype = <0x00 0x00>;
			status = "okay";
		};
	};

	fragment@33 {
		target = <0xffffffff>;

		__overlay__ {
			mediatek,key-debounce = <0x400>;
			mediatek,sw-pwrkey = <0x74>;
			mediatek,hw-pwrkey = <0x08>;
			mediatek,sw-rstkey = <0x73>;
			mediatek,hw-rstkey = <0x11>;
			mediatek,use-extend-type = <0x00>;
			mediatek,hw-map-num = <0x48>;
			mediatek,hw-init-map = <0x72 0x00 0x00 0x00 0x00 0x00 0x00 0x00 0x00 0x00 0x00 0x00 0x00 0x00 0x00 0x00 0x00 0x00 0x00 0x00 0x00 0x00 0x00 0x00 0x00 0x00 0x00 0x00 0x00 0x00 0x00 0x00 0x00 0x00 0x00 0x00 0x00 0x00 0x00 0x00 0x00 0x00 0x00 0x00 0x00 0x00 0x00 0x00 0x00 0x00 0x00 0x00 0x00 0x00 0x00 0x00 0x00 0x00 0x00 0x00 0x00 0x00 0x00 0x00 0x00 0x00 0x00 0x00 0x00 0x00 0x00 0x00>;
			mediatek,pwrkey-eint-gpio = <0x00>;
			mediatek,pwkey-gpio-din = <0x00>;
			mediatek,hw-dl-key0 = <0x11>;
			mediatek,hw-dl-key1 = <0x00>;
			mediatek,hw-dl-key2 = <0x08>;
			mediatek,hw-recovery-key = <0x11>;
			mediatek,hw-factory-key = <0x00>;
			status = "okay";
		};
	};

	fragment@34 {
		target = <0xffffffff>;

		__overlay__ {
			status = "okay";
			#address-cells = <0x01>;
			#size-cells = <0x00>;

			gdx-cli@0 {
				status = "ok";
				compatible = "goodix,gt9916r", "focaltech_ts";
				reg = <0x00>;
				spi-max-frequency = <0x1312d00>;
				focaltech,max-touch-number = <0x0a>;
				focaltech,super-resolution-factors = <0x0a>;
				focaltech,display-coords = <0x00 0x00 0x4c40 0xa980>;
				focaltech,irq-gpio = <0xffffffff 0x07 0x2002>;
				focaltech,reset-gpio = <0xffffffff 0x98 0x00>;
				focaltech,avdd-name = "avdd";
				focaltech,iovdd-name = "iovdd";
				focaltech,touch-range-array = <0x01 0x05 0x0a 0x0f 0x14>;
				focaltech,touch-def-array = <0x04 0x03 0x03 0x03>;
				focaltech,touch-expert-array = <0x0a 0x0f 0x0a 0x0a 0x14 0x0f 0x0f 0x0a 0x0f 0x0f 0x14 0x0a>;
				goodix,panel-max-x-10 = <0x2fa8>;
				goodix,panel-max-y-10 = <0x69f0>;
				goodix,panel-max-x-16 = <0x4c40>;
				goodix,panel-max-y-16 = <0xa980>;
				goodix,panel-max-w = <0x100>;
				goodix,reset-gpio = <0xffffffff 0x98 0x00>;
				goodix,irq-gpio = <0xffffffff 0x07 0x2002>;
				goodix,irq-flags = <0x2002>;
				goodix,iovdd-name = "iovdd";
				iovdd-supply = <0xffffffff>;
				goodix,avdd-name = "avdd";
				avdd-supply = <0xffffffff>;
				goodix,firmware-name = "goodix_firmware.bin";
				goodix,config-name = "goodix_cfg_group.bin";
				pinctrl-names = "pmx_ts_active", "pmx_ts_suspend", "pmx_ts_spi_mode";
				pinctrl-0 = <0x1f 0x20>;
				pinctrl-1 = <0x21 0x22>;
				pinctrl-2 = <0x23>;
			};
		};
	};

	fragment@35 {
		target = <0xffffffff>;

		__overlay__ {
			regulator-min-microvolt = <0x1b7740>;
			regulator-max-microvolt = <0x1b7740>;
		};
	};

	fragment@36 {
		target = <0xffffffff>;

		__overlay__ {
			regulator-min-microvolt = <0x325aa0>;
			regulator-max-microvolt = <0x325aa0>;
		};
	};

	fragment@37 {
		target = <0xffffffff>;

		__overlay__ {

			ts_reset_active {
				phandle = <0x1f>;

				pins_cmd_dat {
					pinmux = <0x9800>;
					bias-disable;
				};
			};

			ts_int_active {
				phandle = <0x20>;

				pins_cmd_dat {
					pinmux = <0x700>;
					bias-disable;
				};
			};

			ts_int_suspend {
				phandle = <0x21>;

				pins_cmd_dat {
					pinmux = <0x700>;
					slew-rate = <0x00>;
					bias-disable;
				};
			};

			ts_reset_suspend {
				phandle = <0x22>;

				pins_cmd_dat {
					pinmux = <0x9800>;
					slew-rate = <0x01>;
					bias-pull-down;
				};
			};

			ts_spimode {
				phandle = <0x23>;

				pins_cmd_dat {
					pinmux = <0x4402 0x4502 0x4602 0x4702>;
					drive-strength = <0x02>;
				};
			};
		};
	};

	fragment@38 {
		target = <0xffffffff>;

		__overlay__ {

			seninf-csi-port-0 {
				compatible = "mediatek,seninf";
				csi-port = "0";
				nvmem-cells = <0xffffffff>;
				nvmem-cell-names = "rg_csi";
				phandle = <0x75>;

				port {

					endpoint {
						remote-endpoint = <0x24>;
						phandle = <0x50>;
					};
				};
			};

			seninf-csi-port-1 {
				compatible = "mediatek,seninf";
				csi-port = "1";
				nvmem-cells = <0xffffffff>;
				nvmem-cell-names = "rg_csi";
				phandle = <0x76>;

				port {

					endpoint {
						remote-endpoint = <0x25>;
						phandle = <0x35>;
					};
				};
			};

			seninf-csi-port-2 {
				compatible = "mediatek,seninf";
				csi-port = "2B";
				nvmem-cells = <0xffffffff>;
				nvmem-cell-names = "rg_csi";
				phandle = <0x77>;

				port {

					endpoint {
						remote-endpoint = <0x26>;
						phandle = <0x48>;
					};
				};
			};

			seninf-csi-port-3 {
				compatible = "mediatek,seninf";
				csi-port = "3";
				nvmem-cells = <0xffffffff>;
				nvmem-cell-names = "rg_csi";
				phandle = <0x78>;

				port {

					endpoint {
						remote-endpoint = <0x27>;
						phandle = <0x40>;
					};
				};
			};
		};
	};

	fragment@39 {
		target = <0xffffffff>;

		__overlay__ {

			camera-wide-avdd {
				compatible = "regulator-fixed";
				regulator-name = "camera-wide-avdd";
				regulator-min-microvolt = <0x2ab980>;
				regulator-max-microvolt = <0x2ab980>;
				enable-active-high;
				gpio = <0xffffffff 0x17 0x00>;
				phandle = <0x31>;
			};

			camera-wide-dvdd {
				compatible = "regulator-fixed";
				regulator-name = "camera-wide-dvdd";
				regulator-min-microvolt = <0x124f80>;
				regulator-max-microvolt = <0x124f80>;
				enable-active-high;
				gpio = <0xffffffff 0xbf 0x00>;
				phandle = <0x32>;
			};

			camera-uw-f-macro-avdd {
				compatible = "regulator-fixed";
				regulator-name = "camera-uw-f-macro-avdd";
				regulator-min-microvolt = <0x2ab980>;
				regulator-max-microvolt = <0x2ab980>;
				enable-active-high;
				gpio = <0xffffffff 0xb9 0x00>;
				phandle = <0x3e>;
			};
		};
	};

	fragment@40 {
		target = <0xffffffff>;

		__overlay__ {
			#address-cells = <0x01>;
			#size-cells = <0x00>;

			etek,ldo@50 {
				compatible = "etek,et5904";
				reg = <0x50>;
				index = <0x00>;
				BoardId_gpio1 = <0xffffffff 0x69 0x00>;
				BoardId_gpio2 = <0xffffffff 0x6a 0x00>;
				BoardId_gpio3 = <0xffffffff 0x71 0x00>;
				phandle = <0x79>;

				on,et5904@0 {
					offset = [00 00];
					regulator-name = "et5904-l1";
					regulator-min-microvolt = <0x80e80>;
					regulator-max-microvolt = <0x16f300>;
					min-dropout-voltage = <0x36ee8>;
					init-voltage = <0x124f80>;
					iout_ua = <0x9eb10>;
					phandle = <0x33>;
				};

				on,et5904@1 {
					offset = [00 01];
					regulator-name = "et5904-l2";
					regulator-min-microvolt = <0x80e80>;
					regulator-max-microvolt = <0x16f300>;
					min-dropout-voltage = <0x36ee8>;
					init-voltage = <0x124f80>;
					iout_ua = <0x9eb10>;
					phandle = <0x3f>;
				};

				on,et5904@2 {
					offset = [00 02];
					regulator-name = "et5904-l3";
					regulator-min-microvolt = <0x16f300>;
					regulator-max-microvolt = <0x33e140>;
					min-dropout-voltage = <0x30d40>;
					init-voltage = <0x2ab980>;
					iout_ua = <0x9eb10>;
					phandle = <0x34>;
				};

				on,et5904@3 {
					offset = [00 03];
					regulator-name = "et5904-l4";
					regulator-min-microvolt = <0x16f300>;
					regulator-max-microvolt = <0x33e140>;
					min-dropout-voltage = <0x30d40>;
					init-voltage = <0x2ab980>;
					iout_ua = <0x9eb10>;
					phandle = <0x28>;
				};
			};
		};
	};

	fragment@41 {
		target = <0xffffffff>;

		__overlay__ {

			camera-pins-cam0-mclk-off {
				phandle = <0x2a>;

				pins-cmd-dat {
					pinmux = <0x5d00>;
					drive-strength = <0x01>;
				};
			};

			camera-pins-cam0-mclk-2ma {
				phandle = <0x2b>;

				pins-cmd-dat {
					pinmux = <0x5d01>;
					drive-strength = <0x00>;
				};
			};

			camera-pins-cam0-mclk-4ma {
				phandle = <0x2c>;

				pins-cmd-dat {
					pinmux = <0x5d01>;
					drive-strength = <0x01>;
				};
			};

			camera-pins-cam0-mclk-6ma {
				phandle = <0x2d>;

				pins-cmd-dat {
					pinmux = <0x5d01>;
					drive-strength = <0x02>;
				};
			};

			camera-pins-cam0-mclk-8ma {
				phandle = <0x2e>;

				pins-cmd-dat {
					pinmux = <0x5d01>;
					drive-strength = <0x03>;
				};
			};

			cam0@0 {
				phandle = <0x2f>;

				pins-cmd-dat {
					pinmux = <0x1900>;
					slew-rate = <0x01>;
					output-low;
				};
			};

			cam0@1 {
				phandle = <0x30>;

				pins-cmd-dat {
					pinmux = <0x1900>;
					slew-rate = <0x01>;
					output-high;
				};
			};

			camera-pins-cam1-mclk-off {
				phandle = <0x49>;

				pins-cmd-dat {
					pinmux = <0x6000>;
					drive-strength = <0x01>;
				};
			};

			camera-pins-cam1-mclk-2ma {
				phandle = <0x4a>;

				pins-cmd-dat {
					pinmux = <0x6001>;
					drive-strength = <0x00>;
				};
			};

			camera-pins-cam1-mclk-4ma {
				phandle = <0x4b>;

				pins-cmd-dat {
					pinmux = <0x6001>;
					drive-strength = <0x01>;
				};
			};

			camera-pins-cam1-mclk-6ma {
				phandle = <0x4c>;

				pins-cmd-dat {
					pinmux = <0x6001>;
					drive-strength = <0x02>;
				};
			};

			camera-pins-cam1-mclk-8ma {
				phandle = <0x4d>;

				pins-cmd-dat {
					pinmux = <0x6001>;
					drive-strength = <0x03>;
				};
			};

			cam1@0 {
				phandle = <0x4e>;

				pins-cmd-dat {
					pinmux = <0x1800>;
					slew-rate = <0x01>;
					output-low;
				};
			};

			cam1@1 {
				phandle = <0x4f>;

				pins-cmd-dat {
					pinmux = <0x1800>;
					slew-rate = <0x01>;
					output-high;
				};
			};

			camera-pins-cam2-mclk-off {
				phandle = <0x37>;

				pins-cmd-dat {
					pinmux = <0x5e00>;
					drive-strength = <0x01>;
				};
			};

			camera-pins-cam2-mclk-2ma {
				phandle = <0x38>;

				pins-cmd-dat {
					pinmux = <0x5e01>;
					drive-strength = <0x00>;
				};
			};

			camera-pins-cam2-mclk-4ma {
				phandle = <0x39>;

				pins-cmd-dat {
					pinmux = <0x5e01>;
					drive-strength = <0x01>;
				};
			};

			camera-pins-cam2-mclk-6ma {
				phandle = <0x3a>;

				pins-cmd-dat {
					pinmux = <0x5e01>;
					drive-strength = <0x02>;
				};
			};

			camera-pins-cam2-mclk-8ma {
				phandle = <0x3b>;

				pins-cmd-dat {
					pinmux = <0x5e01>;
					drive-strength = <0x03>;
				};
			};

			cam2@0 {
				phandle = <0x3c>;

				pins-cmd-dat {
					pinmux = <0x1a00>;
					slew-rate = <0x01>;
					output-low;
				};
			};

			cam2@1 {
				phandle = <0x3d>;

				pins-cmd-dat {
					pinmux = <0x1a00>;
					slew-rate = <0x01>;
					output-high;
				};
			};

			camera-pins-cam3-mclk-off {
				phandle = <0x41>;

				pins-cmd-dat {
					pinmux = <0x5f00>;
					drive-strength = <0x01>;
				};
			};

			camera-pins-cam3-mclk-2ma {
				phandle = <0x42>;

				pins-cmd-dat {
					pinmux = <0x5f01>;
					drive-strength = <0x00>;
				};
			};

			camera-pins-cam3-mclk-4ma {
				phandle = <0x43>;

				pins-cmd-dat {
					pinmux = <0x5f01>;
					drive-strength = <0x01>;
				};
			};

			camera-pins-cam3-mclk-6ma {
				phandle = <0x44>;

				pins-cmd-dat {
					pinmux = <0x5f01>;
					drive-strength = <0x02>;
				};
			};

			camera-pins-cam3-mclk-8ma {
				phandle = <0x45>;

				pins-cmd-dat {
					pinmux = <0x5f01>;
					drive-strength = <0x03>;
				};
			};

			cam3@0 {
				phandle = <0x46>;

				pins-cmd-dat {
					pinmux = <0x1b00>;
					slew-rate = <0x01>;
					output-low;
				};
			};

			cam3@1 {
				phandle = <0x47>;

				pins-cmd-dat {
					pinmux = <0x1b00>;
					slew-rate = <0x01>;
					output-high;
				};
			};

			camdefault {
				phandle = <0x7a>;
			};
		};
	};

	fragment@42 {
		target = <0xffffffff>;

		__overlay__ {
			status = "okay";
			clock-frequency = <0xf4240>;

			camera-eeprom0@51 {
				compatible = "mediatek,camera_eeprom";
				reg = <0x51>;
				status = "okay";
				phandle = <0x7b>;
			};

			camera-af-main@a {
				compatible = "mediatek,main_vcm";
				reg = <0x0a>;
				vin-supply = <0x28>;

				port {

					endpoint {
						remote-endpoint = <0x29>;
						phandle = <0x36>;
					};
				};
			};

			sensor0@10 {
				compatible = "mediatek,imgsensor";
				sensor-names = "malachiteimx882wide_mipi_raw", "malachites5khp3wide_mipi_raw";
				reg = <0x10>;
				BoardId_gpio1 = <0xffffffff 0x69 0x00>;
				BoardId_gpio2 = <0xffffffff 0x6a 0x00>;
				BoardId_gpio3 = <0xffffffff 0x71 0x00>;
				#thermal-sensor-cells = <0x00>;
				pinctrl-names = "mclk_off", "mclk_2mA", "mclk_4mA", "mclk_6mA", "mclk_8mA", "rst_low", "rst_high";
				pinctrl-0 = <0x2a>;
				pinctrl-1 = <0x2b>;
				pinctrl-2 = <0x2c>;
				pinctrl-3 = <0x2d>;
				pinctrl-4 = <0x2e>;
				pinctrl-5 = <0x2f>;
				pinctrl-6 = <0x30>;
				avdd-supply = <0x31>;
				dvdd-supply = <0x32>;
				dvdd1-supply = <0x33>;
				afvdd-supply = <0x28>;
				dovdd-supply = <0xffffffff>;
				avdd1-supply = <0x34>;
				clocks = <0xffffffff 0x88 0xffffffff 0x87 0xffffffff 0xbd 0xffffffff 0x86 0xffffffff 0x85 0xffffffff 0xae 0xffffffff 0x7e 0xffffffff 0x08>;
				clock-names = "6", "12", "13", "19.2", "24", "26", "52", "mclk";
				status = "okay";
				phandle = <0x51>;

				port {

					endpoint {
						remote-endpoint = <0x35>;
						phandle = <0x25>;
					};
				};
			};
		};
	};

	fragment@43 {
		target = <0xffffffff>;

		__overlay__ {
			#address-cells = <0x01>;
			#size-cells = <0x00>;

			port@0 {
				reg = <0x00>;

				endpoint {
					remote-endpoint = <0x36>;
					phandle = <0x29>;
				};
			};
		};
	};

	fragment@44 {
		target = <0xffffffff>;

		__overlay__ {
			status = "okay";
			clock-frequency = <0x61a80>;

			sensor2@1A {
				compatible = "mediatek,imgsensor";
				sensor-names = "malachiteimx355ultra_mipi_raw";
				reg = <0x10>;
				#thermal-sensor-cells = <0x00>;
				pinctrl-names = "mclk_off", "mclk_2mA", "mclk_4mA", "mclk_6mA", "mclk_8mA", "rst_low", "rst_high";
				pinctrl-0 = <0x37>;
				pinctrl-1 = <0x38>;
				pinctrl-2 = <0x39>;
				pinctrl-3 = <0x3a>;
				pinctrl-4 = <0x3b>;
				pinctrl-5 = <0x3c>;
				pinctrl-6 = <0x3d>;
				avdd-supply = <0x3e>;
				dvdd-supply = <0x3f>;
				dovdd-supply = <0xffffffff>;
				clocks = <0xffffffff 0x88 0xffffffff 0x87 0xffffffff 0xbd 0xffffffff 0x86 0xffffffff 0x85 0xffffffff 0xae 0xffffffff 0x7e 0xffffffff 0x09>;
				clock-names = "6", "12", "13", "19.2", "24", "26", "52", "mclk";
				status = "okay";
				phandle = <0x53>;

				port {

					endpoint {
						remote-endpoint = <0x40>;
						phandle = <0x27>;
					};
				};
			};

			camera-eeprom2@50 {
				compatible = "mediatek,camera_eeprom";
				reg = <0x50>;
				status = "okay";
				phandle = <0x7c>;
			};

			sensor3@3C {
				compatible = "mediatek,imgsensor";
				sensor-names = "malachiteov02b10macro_mipi_raw";
				reg = <0x3c>;
				#thermal-sensor-cells = <0x00>;
				pinctrl-names = "mclk_off", "mclk_2mA", "mclk_4mA", "mclk_6mA", "mclk_8mA", "rst_low", "rst_high";
				pinctrl-0 = <0x41>;
				pinctrl-1 = <0x42>;
				pinctrl-2 = <0x43>;
				pinctrl-3 = <0x44>;
				pinctrl-4 = <0x45>;
				pinctrl-5 = <0x46>;
				pinctrl-6 = <0x47>;
				avdd-supply = <0x3e>;
				dovdd-supply = <0xffffffff>;
				clocks = <0xffffffff 0x88 0xffffffff 0x87 0xffffffff 0xbd 0xffffffff 0x86 0xffffffff 0x85 0xffffffff 0xae 0xffffffff 0x7e 0xffffffff 0x0a>;
				clock-names = "6", "12", "13", "19.2", "24", "26", "52", "mclk";
				status = "okay";
				phandle = <0x54>;

				port {

					endpoint {
						remote-endpoint = <0x48>;
						phandle = <0x26>;
					};
				};
			};

			camera-eeprom3@52 {
				compatible = "mediatek,camera_eeprom";
				reg = <0x52>;
				status = "okay";
				phandle = <0x7d>;
			};
		};
	};

	fragment@45 {
		target = <0xffffffff>;

		__overlay__ {
			status = "okay";
			clock-frequency = <0xf4240>;

			sensor1@10 {
				compatible = "mediatek,imgsensor";
				sensor-names = "malachiteov20bfront_mipi_raw";
				reg = <0x10>;
				pinctrl-names = "mclk_off", "mclk_2mA", "mclk_4mA", "mclk_6mA", "mclk_8mA", "rst_low", "rst_high";
				pinctrl-0 = <0x49>;
				pinctrl-1 = <0x4a>;
				pinctrl-2 = <0x4b>;
				pinctrl-3 = <0x4c>;
				pinctrl-4 = <0x4d>;
				pinctrl-5 = <0x4e>;
				pinctrl-6 = <0x4f>;
				avdd-supply = <0x3e>;
				dvdd-supply = <0x3f>;
				dovdd-supply = <0xffffffff>;
				clocks = <0xffffffff 0x88 0xffffffff 0x87 0xffffffff 0xbd 0xffffffff 0x86 0xffffffff 0x85 0xffffffff 0xae 0xffffffff 0x7e 0xffffffff 0x0b>;
				clock-names = "6", "12", "13", "19.2", "24", "26", "52", "mclk";
				status = "okay";
				phandle = <0x52>;

				port {

					endpoint {
						remote-endpoint = <0x50>;
						phandle = <0x24>;
					};
				};
			};

			camera-eeprom1@51 {
				compatible = "mediatek,camera_eeprom";
				reg = <0x51>;
				status = "okay";
				phandle = <0x7e>;
			};
		};
	};

	fragment@46 {
		target = <0xffffffff>;

		__overlay__ {

			camera0 {
				polling-delay = <0x00>;
				polling-delay-passive = <0x00>;
				thermal-sensors = <0x51>;
				phandle = <0x7f>;

				trips {

					camera0-crit {
						temperature = <0x1d4c0>;
						hysteresis = <0x7d0>;
						type = "passive";
						phandle = <0x80>;
					};
				};
			};

			camera1 {
				polling-delay = <0x00>;
				polling-delay-passive = <0x00>;
				thermal-sensors = <0x52>;
				phandle = <0x81>;

				trips {

					camera1-crit {
						temperature = <0x1d4c0>;
						hysteresis = <0x7d0>;
						type = "passive";
						phandle = <0x82>;
					};
				};
			};

			camera2 {
				polling-delay = <0x00>;
				polling-delay-passive = <0x00>;
				thermal-sensors = <0x53>;
				phandle = <0x83>;

				trips {

					camera2-crit {
						temperature = <0x1d4c0>;
						hysteresis = <0x7d0>;
						type = "passive";
						phandle = <0x84>;
					};
				};
			};

			camera3 {
				polling-delay = <0x00>;
				polling-delay-passive = <0x00>;
				thermal-sensors = <0x54>;
				phandle = <0x85>;

				trips {

					camera3-crit {
						temperature = <0x1d4c0>;
						hysteresis = <0x7d0>;
						type = "passive";
						phandle = <0x86>;
					};
				};
			};
		};
	};

	fragment@47 {
		target = <0xffffffff>;

		__overlay__ {
			pinctrl-names = "default", "hwen_high", "hwen_low", "hwsel_high", "hwsel_low";
			pinctrl-0 = <0x55>;
			pinctrl-1 = <0x56>;
			pinctrl-2 = <0x57>;
			pinctrl-3 = <0x58>;
			pinctrl-4 = <0x59>;
			status = "okay";
		};
	};

	fragment@48 {
		target = <0xffffffff>;

		__overlay__ {

			flashlightdefault {
				phandle = <0x55>;
			};

			flashlightenoutput1 {
				phandle = <0x56>;

				pins_cmd_dat {
					pinmux = <0xc300>;
					slew-rate = <0x01>;
					output-high;
				};
			};

			flashlightenoutput0 {
				phandle = <0x57>;

				pins_cmd_dat {
					pinmux = <0xc300>;
					slew-rate = <0x01>;
					output-low;
				};
			};

			flashlightselflash {
				phandle = <0x58>;

				pins_cmd_dat {
					pinmux = <0x9900>;
					slew-rate = <0x01>;
					output-low;
				};
			};

			flashlightseltorch {
				phandle = <0x59>;

				pins_cmd_dat {
					pinmux = <0x9900>;
					slew-rate = <0x00>;
					bias-disable;
				};
			};
		};
	};

	fragment@49 {
		target = <0xffffffff>;

		__overlay__ {
			binding-core = <0x04 0x05 0x06>;
		};
	};

	fragment@50 {
		target = <0xffffffff>;

		__overlay__ {

			epa-elna-mtk {
				parts = <0xffffffff 0xffffffff 0xffffffff 0xffffffff 0xffffffff 0xffffffff 0xffffffff 0xffffffff 0xffffffff 0xffffffff 0xffffffff 0xffffffff 0xffffffff 0xffffffff 0xffffffff 0xffffffff>;

				hwid {
					gpio = <0xffffffff 0x83 0x00 0xffffffff 0x84 0x00 0xffffffff 0x5c 0x00>;
				};

				wifi {

					flags-3 {
					};

					flags-4 {
					};

					flags-5 {
					};

					flags-6 {
					};

					flags-7 {
					};
				};

				bt {

					flags-3 {
						bypass;
					};

					flags-4 {
						bypass;
					};

					flags-5 {
						bypass;
					};

					flags-6 {
						epa-elna;
					};

					flags-7 {
						epa-elna;
					};
				};
			};
		};
	};

	fragment@51 {
		target = <0xffffffff>;

		__overlay__ {

			sc8541@6A {
				compatible = "sc,sc8541-standalone";
				#io-channel-cells = <0x01>;
				reg = <0x6a>;
				interrupt-parent = <0xffffffff>;
				interrupts = <0x0c 0x00>;
				sc8541,intr_gpio = <0xffffffff 0x0c 0x02>;
				charger_name = "primary_dvchg";
				charger_name_v4_19 = "primary_divider_chg";
				sc,sc8541,vbat-ovp-dis = <0x00>;
				sc,sc8541,vbat-ovp = <0x5a>;
				sc,sc8541,vbat-ovp-alm-dis = <0x01>;
				sc,sc8541,vbat-ovp-alm = <0x46>;
				sc,sc8541,ibat-ocp-dis = <0x00>;
				sc,sc8541,ibat-ocp = <0x7f>;
				sc,sc8541,ibat-ocp-alm-dis = <0x01>;
				sc,sc8541,ibat-ocp-alm = <0x50>;
				sc,sc8541,ibus-ucp-dis = <0x00>;
				sc,sc8541,vbus-in-range-dis = <0x00>;
				sc,sc8541,vbus-pd-en = <0x00>;
				sc,sc8541,vbus-ovp = <0x64>;
				sc,sc8541,vbus-ovp-alm-dis = <0x01>;
				sc,sc8541,vbus-ovp-alm = <0x64>;
				sc,sc8541,ibus-ocp-dis = <0x00>;
				sc,sc8541,ibus-ocp = <0x15>;
				sc,sc8541,tshut-dis = <0x01>;
				sc,sc8541,tsbus-flt-dis = <0x01>;
				sc,sc8541,tsbat-flt-dis = <0x01>;
				sc,sc8541,tdie-alm = <0xc8>;
				sc,sc8541,tsbus-flt = <0x15>;
				sc,sc8541,tsbat-flt = <0x15>;
				sc,sc8541,vac1-ovp = <0x03>;
				sc,sc8541,vac2-ovp = <0x03>;
				sc,sc8541,vac1-pd-en = <0x00>;
				sc,sc8541,vac2-pd-en = <0x00>;
				sc,sc8541,fsw-set = <0x04>;
				sc,sc8541,wd-timeout = <0x00>;
				sc,sc8541,wd-timeout-dis = <0x01>;
				sc,sc8541,ibat-sns-r = <0x00>;
				sc,sc8541,ss-timeout = <0x07>;
				sc,sc8541,ibus-ucp-fall-dg = <0x01>;
				sc,sc8541,vout-ovp-dis = <0x00>;
				sc,sc8541,vout-ovp = <0x03>;
				sc,sc8541,pmid2out-uvp = <0x07>;
				sc,sc8541,pmid2out-ovp = <0x07>;
				phandle = <0x87>;
			};

			bq25960@65 {
				compatible = "bq,bq25960-standalone";
				#io-channel-cells = <0x01>;
				status = "ok";
				reg = <0x65>;
				bq25960,intr_gpio = <0xffffffff 0x0c 0x02>;
				charger_name = "primary_dvchg";
				bq,bq25960,vbat-ovp-dis = <0x00>;
				bq,bq25960,vbat-ovp = <0x7f>;
				bq,bq25960,vbat-ovp-alm-dis = <0x01>;
				bq,bq25960,vbat-ovp-alm = <0x7a>;
				bq,bq25960,ibat-ocp-dis = <0x00>;
				bq,bq25960,ibat-ocp = <0x41>;
				bq,bq25960,ibat-ocp-alm-dis = <0x01>;
				bq,bq25960,ibat-ocp-alm = <0x41>;
				bq,bq25960,ibus-ucp-dis = <0x00>;
				bq,bq25960,ibus-ucp = <0x00>;
				bq,bq25960,chg-config-2 = <0x00>;
				bq,bq25960,vbus-pd-en = <0x00>;
				bq,bq25960,vbus-ovp = <0x64>;
				bq,bq25960,vbus-ovp-alm-dis = <0x01>;
				bq,bq25960,vbus-ovp-alm = <0x64>;
				bq,bq25960,ibus-ocp = <0x15>;
				bq,bq25960,tsbus-flt-dis = <0x01>;
				bq,bq25960,tsbat-flt-dis = <0x01>;
				bq,bq25960,tdie-alm = <0xc8>;
				bq,bq25960,tsbus-flt = <0x15>;
				bq,bq25960,tsbat-flt = <0x15>;
				bq,bq25960,vac1-ovp = <0x03>;
				bq,bq25960,vac2-ovp = <0x03>;
				bq,bq25960,vac1-pd-en = <0x00>;
				bq,bq25960,vac2-pd-en = <0x00>;
				bq,bq25960,fsw-set = <0x04>;
				bq,bq25960,wd-timeout = <0x00>;
				bq,bq25960,wd-timeout-dis = <0x01>;
				bq,bq25960,ibat-sns-r = <0x00>;
				bq,bq25960,ss-timeout = <0x07>;
				bq,bq25960,ibus-ucp-fall-dg = <0x01>;
				bq,bq25960,vout-ovp-dis = <0x00>;
				bq,bq25960,ms = <0x00>;
				bq,bq25960,vout-ovp = <0x03>;
				phandle = <0x88>;
			};
		};
	};

	fragment@52 {
		target = <0xffffffff>;

		__overlay__ {
			compatible = "mediatek,charger,pe";
			status = "disabled";
		};
	};

	fragment@53 {
		target = <0xffffffff>;

		__overlay__ {
			compatible = "mediatek,charger,pe2";
			status = "disabled";
		};
	};

	fragment@54 {
		target = <0xffffffff>;

		__overlay__ {
			compatible = "mediatek,charger,pd";
			status = "disabled";
		};
	};

	fragment@55 {
		target = <0xffffffff>;

		__overlay__ {
			compatible = "mediatek,charger,pe45";
			status = "disabled";
		};
	};

	fragment@56 {
		target = <0xffffffff>;

		__overlay__ {
			compatible = "mediatek,charger,pe5";
			status = "disabled";
		};
	};

	fragment@57 {
		target = <0xffffffff>;

		__overlay__ {
			compatible = "mediatek,charger,pe5p";
			status = "disabled";
		};
	};

	fragment@58 {
		target = <0xffffffff>;

		__overlay__ {
			max_charger_voltage = <0xa7d8c0>;
			fv = <0x1194>;
			fv_normal = <0x1180>;
			fv_ffc = <0x11b2>;
			iterm = <0xfa>;
			iterm_warm = <0xfa>;
			iterm_warm_cn = <0x10e>;
			usb_charger_current = <0x7a120>;
			ac_charger_current = <0x186a00>;
			ac_charger_input_current = <0x186a00>;
			charging_host_charger_current = <0x16e360>;
			ffc_low_tbat = <0x96>;
			ffc_medium_tbat = <0x12c>;
			ffc_warm_tbat = <0x15e>;
			ffc_little_high_tbat = <0x190>;
			ffc_high_tbat = <0x1c2>;
			ffc_high_soc = <0x5a>;
			step_fallback_hyst = <0x19>;
			step_forward_hyst = <0x05>;
			jeita_fallback_hyst = <0x0a>;
			jeita_forward_hyst = <0x00>;
			mt6369_moscon1_control;
			en_floatgnd;
			rust_support;
			min_charger_voltage_1 = <0x4630c0>;
			min_charger_voltage_2 = <0x44aa20>;
			min-charge-temp = <0xfffffff6>;
			min-charge-temp-plus-x-degree = <0xfffffff8>;
			max-charge-temp = <0x3a>;
			max-charge-temp-minus-x-degree = <0x38>;
			jeita_fcc_cfg_gl = <0xffffff9c 0xffffffff 0x1194 0x1f7 0x1f7 0x00 0x31 0x1036 0x3ee 0x3ee 0x32 0x63 0x1036 0x992 0x992 0x64 0x95 0x1036 0xf6e 0xf6e 0x96 0x1c1 0x1036 0x1e14 0x1518 0x1c2 0x257 0x1004 0x9d3 0x9d3>;
			jeita_fcc_cfg_cn = <0xffffff9c 0xffffffff 0x1194 0x21e 0x21e 0x00 0x31 0x1036 0x3e8 0x3e8 0x32 0x63 0x1036 0xa28 0xa28 0x64 0x95 0x1036 0x109a 0x109a 0x96 0x1c1 0x1036 0x1e14 0x1518 0x1c2 0x257 0x1004 0xa96 0xa96>;
			jeita_fv_cfg = <0xffffff9c 0xffffffff 0x1194 0x00 0x31 0x1194 0x32 0x63 0x1194 0x64 0x95 0x1194 0x96 0x1c1 0x11b2 0x1c2 0x257 0x1004>;
			step_chg_cfg_1_cycle = <0xbb8 0x1036 0x1f40 0x1037 0x10cc 0x1770 0x10cd 0x1194 0x1518 0x1195 0x11b2 0x10f0>;
			step_chg_cfg_1_cycle_gl = <0xbb8 0x1036 0x1f40 0x1037 0x10cc 0x1770 0x10cd 0x1194 0x1518 0x1195 0x11b2 0xfb8>;
			step_chg_cfg_1_cycle_normal = <0xbb8 0x1036 0x1f40 0x1037 0x1180 0x1518 0x117f 0x1180 0x1518 0x117f 0x1180 0x1518>;
			iterm_ffc_1_cycle_0 = <0x2f6>;
			iterm_ffc_little_warm_1_cycle_0 = <0x43c>;
			iterm_ffc_warm_1_cycle_0 = <0x4c3>;
			iterm_ffc_hot_1_cycle_0 = <0x54b>;
			iterm_ffc_1_cycle_1 = <0x438>;
			iterm_ffc_little_warm_1_cycle_1 = <0x60a>;
			iterm_ffc_warm_1_cycle_1 = <0x762>;
			iterm_ffc_hot_1_cycle_1 = <0x8ba>;
			iterm_ffc_1_cycle_2 = <0x2f2>;
			iterm_ffc_little_warm_1_cycle_2 = <0x485>;
			iterm_ffc_warm_1_cycle_2 = <0x4e9>;
			iterm_ffc_hot_1_cycle_2 = <0x54e>;
			iterm_ffc_1_cycle_3 = <0x43e>;
			iterm_ffc_little_warm_1_cycle_3 = <0x616>;
			iterm_ffc_warm_1_cycle_3 = <0x774>;
			iterm_ffc_hot_1_cycle_3 = <0x8d3>;
			step_chg_cfg_100_cycle = <0xbb8 0x1004 0x1f40 0x1005 0x109a 0x1770 0x109b 0x1162 0x1518 0x1163 0x11b2 0x10f0>;
			step_chg_cfg_100_cycle_gl = <0xbb8 0x1004 0x1f40 0x1005 0x109a 0x1770 0x109b 0x1162 0x1518 0x1163 0x11b2 0xfb8>;
			step_chg_cfg_100_cycle_normal = <0xbb8 0x1018 0x1f40 0x1019 0x1176 0x1518 0x1175 0x1176 0x1518 0x1175 0x1176 0x1518>;
			iterm_ffc_100_cycle_0 = <0x2f6>;
			iterm_ffc_little_warm_100_cycle_0 = <0x399>;
			iterm_ffc_warm_100_cycle_0 = <0x472>;
			iterm_ffc_hot_100_cycle_0 = <0x54b>;
			iterm_ffc_100_cycle_1 = <0x4df>;
			iterm_ffc_little_warm_100_cycle_1 = <0x60a>;
			iterm_ffc_warm_100_cycle_1 = <0x762>;
			iterm_ffc_hot_100_cycle_1 = <0x8ba>;
			iterm_ffc_100_cycle_2 = <0x324>;
			iterm_ffc_little_warm_100_cycle_2 = <0x43e>;
			iterm_ffc_warm_100_cycle_2 = <0x49e>;
			iterm_ffc_hot_100_cycle_2 = <0x54e>;
			iterm_ffc_100_cycle_3 = <0x4b6>;
			iterm_ffc_little_warm_100_cycle_3 = <0x616>;
			iterm_ffc_warm_100_cycle_3 = <0x774>;
			iterm_ffc_hot_100_cycle_3 = <0x8d3>;
			step_chg_cfg_200_cycle = <0xbb8 0x1004 0x1f40 0x1005 0x109a 0x1770 0x109b 0x1162 0x1518 0x1163 0x11b2 0x10f0>;
			step_chg_cfg_200_cycle_gl = <0xbb8 0x1004 0x1f40 0x1005 0x109a 0x1770 0x109b 0x1162 0x1518 0x1163 0x11b2 0xfb8>;
			step_chg_cfg_200_cycle_normal = <0xbb8 0x1018 0x1f40 0x1019 0x1176 0x1518 0x1175 0x1176 0x1518 0x1175 0x1176 0x1518>;
			iterm_ffc_200_cycle_0 = <0x2c0>;
			iterm_ffc_little_warm_200_cycle_0 = <0x32d>;
			iterm_ffc_warm_200_cycle_0 = <0x3cf>;
			iterm_ffc_hot_200_cycle_0 = <0x472>;
			iterm_ffc_200_cycle_1 = <0x4a9>;
			iterm_ffc_little_warm_200_cycle_1 = <0x568>;
			iterm_ffc_warm_200_cycle_1 = <0x6bf>;
			iterm_ffc_hot_200_cycle_1 = <0x817>;
			iterm_ffc_200_cycle_2 = <0x2c0>;
			iterm_ffc_little_warm_200_cycle_2 = <0x357>;
			iterm_ffc_warm_200_cycle_2 = <0x3d4>;
			iterm_ffc_hot_200_cycle_2 = <0x452>;
			iterm_ffc_200_cycle_3 = <0x43d>;
			iterm_ffc_little_warm_200_cycle_3 = <0x57f>;
			iterm_ffc_warm_200_cycle_3 = <0x710>;
			iterm_ffc_hot_200_cycle_3 = <0x8a2>;
			step_chg_cfg_300_cycle = <0xbb8 0xfe6 0x1f40 0xfe7 0x107c 0x1770 0x107d 0x1144 0x1518 0x1145 0x11b2 0x10f0>;
			step_chg_cfg_300_cycle_gl = <0xbb8 0xfe6 0x1f40 0xfe7 0x107c 0x1770 0x107d 0x1144 0x1518 0x1145 0x11b2 0xfb8>;
			step_chg_cfg_300_cycle_normal = <0xbb8 0x1018 0x1f40 0x1019 0x1176 0x1518 0x1175 0x1176 0x1518 0x1175 0x1176 0x1518>;
			iterm_ffc_300_cycle_0 = <0x28a>;
			iterm_ffc_little_warm_300_cycle_0 = <0x2f6>;
			iterm_ffc_warm_300_cycle_0 = <0x3b4>;
			iterm_ffc_hot_300_cycle_0 = <0x472>;
			iterm_ffc_300_cycle_1 = <0x438>;
			iterm_ffc_little_warm_300_cycle_1 = <0x568>;
			iterm_ffc_warm_300_cycle_1 = <0x6bf>;
			iterm_ffc_hot_300_cycle_1 = <0x817>;
			iterm_ffc_300_cycle_2 = <0x28d>;
			iterm_ffc_little_warm_300_cycle_2 = <0x324>;
			iterm_ffc_warm_300_cycle_2 = <0x3bb>;
			iterm_ffc_hot_300_cycle_2 = <0x452>;
			iterm_ffc_300_cycle_3 = <0x3bb>;
			iterm_ffc_little_warm_300_cycle_3 = <0x54c>;
			iterm_ffc_warm_300_cycle_3 = <0x6f7>;
			iterm_ffc_hot_300_cycle_3 = <0x8a2>;
			step_chg_cfg_400_cycle = <0xbb8 0xfe6 0x1f40 0xfe7 0x107c 0x1770 0x107d 0x1144 0x1518 0x1145 0x11b2 0x10f0>;
			step_chg_cfg_400_cycle_gl = <0xbb8 0xfe6 0x1f40 0xfe7 0x107c 0x1770 0x107d 0x1144 0x1518 0x1145 0x11b2 0xfb8>;
			step_chg_cfg_400_cycle_normal = <0xbb8 0x1018 0x1f40 0x1019 0x116c 0x1518 0x116b 0x116c 0x1518 0x116b 0x116c 0x1518>;
			iterm_ffc_400_cycle_0 = <0x254>;
			iterm_ffc_little_warm_400_cycle_0 = <0x2c0>;
			iterm_ffc_warm_400_cycle_0 = <0x348>;
			iterm_ffc_hot_400_cycle_0 = <0x4a8>;
			iterm_ffc_400_cycle_1 = <0x3d0>;
			iterm_ffc_little_warm_400_cycle_1 = <0x4fc>;
			iterm_ffc_warm_400_cycle_1 = <0x668>;
			iterm_ffc_hot_400_cycle_1 = <0x884>;
			iterm_ffc_400_cycle_2 = <0x25b>;
			iterm_ffc_little_warm_400_cycle_2 = <0x2f2>;
			iterm_ffc_warm_400_cycle_2 = <0x357>;
			iterm_ffc_hot_400_cycle_2 = <0x4b7>;
			iterm_ffc_400_cycle_3 = <0x389>;
			iterm_ffc_little_warm_400_cycle_3 = <0x51a>;
			iterm_ffc_warm_400_cycle_3 = <0x648>;
			iterm_ffc_hot_400_cycle_3 = <0x80b>;
			step_chg_cfg_500_cycle = <0xbb8 0xfe6 0x1f40 0xfe7 0x107c 0x1770 0x107d 0x1144 0x1518 0x1145 0x11b2 0x10f0>;
			step_chg_cfg_500_cycle_gl = <0xbb8 0xfe6 0x1f40 0xfe7 0x107c 0x1770 0x107d 0x1144 0x1518 0x1145 0x11b2 0xfb8>;
			step_chg_cfg_500_cycle_normal = <0xbb8 0x1018 0x1f40 0x1019 0x116c 0x1518 0x116b 0x116c 0x1518 0x116b 0x116c 0x1518>;
			iterm_ffc_500_cycle_0 = <0x254>;
			iterm_ffc_little_warm_500_cycle_0 = <0x28a>;
			iterm_ffc_warm_500_cycle_0 = <0x32d>;
			iterm_ffc_hot_500_cycle_0 = <0x54b>;
			iterm_ffc_500_cycle_1 = <0x399>;
			iterm_ffc_little_warm_500_cycle_1 = <0x4c5>;
			iterm_ffc_warm_500_cycle_1 = <0x636>;
			iterm_ffc_hot_500_cycle_1 = <0x8ba>;
			iterm_ffc_500_cycle_2 = <0x229>;
			iterm_ffc_little_warm_500_cycle_2 = <0x2c0>;
			iterm_ffc_warm_500_cycle_2 = <0x33d>;
			iterm_ffc_hot_500_cycle_2 = <0x54e>;
			iterm_ffc_500_cycle_3 = <0x357>;
			iterm_ffc_little_warm_500_cycle_3 = <0x4e7>;
			iterm_ffc_warm_500_cycle_3 = <0x616>;
			iterm_ffc_hot_500_cycle_3 = <0x8d3>;
			step_chg_cfg_600_cycle = <0xbb8 0xfe6 0x1f40 0xfe7 0x107c 0x1770 0x107d 0x1144 0x1518 0x1145 0x11b2 0x10f0>;
			step_chg_cfg_600_cycle_gl = <0xbb8 0xfe6 0x1f40 0xfe7 0x107c 0x1770 0x107d 0x1144 0x1518 0x1145 0x11b2 0xfb8>;
			step_chg_cfg_600_cycle_normal = <0xbb8 0x1018 0x1f40 0x1019 0x116c 0x1518 0x116b 0x116c 0x1518 0x116b 0x116c 0x1518>;
			iterm_ffc_600_cycle_0 = <0x21e>;
			iterm_ffc_little_warm_600_cycle_0 = <0x28a>;
			iterm_ffc_warm_600_cycle_0 = <0x437>;
			iterm_ffc_hot_600_cycle_0 = <0x54b>;
			iterm_ffc_600_cycle_1 = <0x363>;
			iterm_ffc_little_warm_600_cycle_1 = <0x48f>;
			iterm_ffc_warm_600_cycle_1 = <0x6bf>;
			iterm_ffc_hot_600_cycle_1 = <0x8ba>;
			iterm_ffc_600_cycle_2 = <0x1ff>;
			iterm_ffc_little_warm_600_cycle_2 = <0x2c0>;
			iterm_ffc_warm_600_cycle_2 = <0x439>;
			iterm_ffc_hot_600_cycle_2 = <0x54e>;
			iterm_ffc_600_cycle_3 = <0x324>;
			iterm_ffc_little_warm_600_cycle_3 = <0x4b5>;
			iterm_ffc_warm_600_cycle_3 = <0x693>;
			iterm_ffc_hot_600_cycle_3 = <0x8d3>;
			step_chg_cfg_700_cycle = <0xbb8 0xfe6 0x1f40 0xfe7 0x107c 0x1770 0x107d 0x1144 0x1518 0x1145 0x11b2 0x10f0>;
			step_chg_cfg_700_cycle_gl = <0xbb8 0xfe6 0x1f40 0xfe7 0x107c 0x1770 0x107d 0x1144 0x1518 0x1145 0x11b2 0xfb8>;
			step_chg_cfg_700_cycle_normal = <0xbb8 0x1018 0x1f40 0x1019 0x116c 0x1518 0x116b 0x116c 0x1518 0x116b 0x116c 0x1518>;
			iterm_ffc_700_cycle_0 = <0x21e>;
			iterm_ffc_little_warm_700_cycle_0 = <0x254>;
			iterm_ffc_warm_700_cycle_0 = <0x4c3>;
			iterm_ffc_hot_700_cycle_0 = <0x54b>;
			iterm_ffc_700_cycle_1 = <0x363>;
			iterm_ffc_little_warm_700_cycle_1 = <0x48f>;
			iterm_ffc_warm_700_cycle_1 = <0x762>;
			iterm_ffc_hot_700_cycle_1 = <0x8ba>;
			iterm_ffc_700_cycle_2 = <0x1ff>;
			iterm_ffc_little_warm_700_cycle_2 = <0x28d>;
			iterm_ffc_warm_700_cycle_2 = <0x4e9>;
			iterm_ffc_hot_700_cycle_2 = <0x54e>;
			iterm_ffc_700_cycle_3 = <0x324>;
			iterm_ffc_little_warm_700_cycle_3 = <0x4b5>;
			iterm_ffc_warm_700_cycle_3 = <0x774>;
			iterm_ffc_hot_700_cycle_3 = <0x8d3>;
			step_chg_cfg_800_cycle = <0xbb8 0xfd2 0x17d4 0xfd3 0x1068 0x12c0 0x1069 0x1130 0x10e0 0x1131 0x11b2 0xe40>;
			step_chg_cfg_800_cycle_gl = <0xbb8 0xfd2 0x17d4 0xfd3 0x1068 0x12c0 0x1069 0x1130 0x10e0 0x1131 0x11b2 0xc93>;
			step_chg_cfg_800_cycle_normal = <0xbb8 0x1018 0x17d4 0x1019 0x1158 0x10e0 0x1157 0x1158 0x10e0 0x1157 0x1158 0x10e0>;
			iterm_ffc_800_cycle_0 = <0x1e7>;
			iterm_ffc_little_warm_800_cycle_0 = <0x254>;
			iterm_ffc_warm_800_cycle_0 = <0x4c3>;
			iterm_ffc_hot_800_cycle_0 = <0x54b>;
			iterm_ffc_800_cycle_1 = <0x32d>;
			iterm_ffc_little_warm_800_cycle_1 = <0x459>;
			iterm_ffc_warm_800_cycle_1 = <0x762>;
			iterm_ffc_hot_800_cycle_1 = <0x8ba>;
			iterm_ffc_800_cycle_2 = <0x1cc>;
			iterm_ffc_little_warm_800_cycle_2 = <0x28d>;
			iterm_ffc_warm_800_cycle_2 = <0x4e9>;
			iterm_ffc_hot_800_cycle_2 = <0x54e>;
			iterm_ffc_800_cycle_3 = <0x2f2>;
			iterm_ffc_little_warm_800_cycle_3 = <0x483>;
			iterm_ffc_warm_800_cycle_3 = <0x774>;
			iterm_ffc_hot_800_cycle_3 = <0x8d3>;
			step_chg_cfg_900_cycle = <0xbb8 0xfd2 0x17d4 0xfd3 0x1068 0x12c0 0x1069 0x1130 0x10e0 0x1131 0x11b2 0xe40>;
			step_chg_cfg_900_cycle_gl = <0xbb8 0xfd2 0x17d4 0xfd3 0x1068 0x12c0 0x1069 0x1130 0x10e0 0x1131 0x11b2 0xc93>;
			step_chg_cfg_900_cycle_normal = <0xbb8 0x1018 0x17d4 0x1019 0x1158 0x10e0 0x1157 0x1158 0x10e0 0x1157 0x1158 0x10e0>;
			iterm_ffc_900_cycle_0 = <0x1e7>;
			iterm_ffc_little_warm_900_cycle_0 = <0x254>;
			iterm_ffc_warm_900_cycle_0 = <0x4c3>;
			iterm_ffc_hot_900_cycle_0 = <0x54b>;
			iterm_ffc_900_cycle_1 = <0x32d>;
			iterm_ffc_little_warm_900_cycle_1 = <0x459>;
			iterm_ffc_warm_900_cycle_1 = <0x762>;
			iterm_ffc_hot_900_cycle_1 = <0x8ba>;
			iterm_ffc_900_cycle_2 = <0x1cc>;
			iterm_ffc_little_warm_900_cycle_2 = <0x28d>;
			iterm_ffc_warm_900_cycle_2 = <0x4e9>;
			iterm_ffc_hot_900_cycle_2 = <0x54e>;
			iterm_ffc_900_cycle_3 = <0x2f2>;
			iterm_ffc_little_warm_900_cycle_3 = <0x483>;
			iterm_ffc_warm_900_cycle_3 = <0x774>;
			iterm_ffc_hot_900_cycle_3 = <0x8d3>;
			step_chg_cfg_1000_cycle = <0xbb8 0xfd2 0x17d4 0xfd3 0x1068 0x12c0 0x1069 0x1130 0x10e0 0x1131 0x11b2 0xe40>;
			step_chg_cfg_1000_cycle_gl = <0xbb8 0xfd2 0x17d4 0xfd3 0x1068 0x12c0 0x1069 0x1130 0x10e0 0x1131 0x11b2 0xc93>;
			step_chg_cfg_1000_cycle_normal = <0xbb8 0x1018 0x17d4 0x1019 0x1158 0x10e0 0x1157 0x1158 0x10e0 0x1157 0x1158 0x10e0>;
			iterm_ffc_1000_cycle_0 = <0x21e>;
			iterm_ffc_little_warm_1000_cycle_0 = <0x2f6>;
			iterm_ffc_warm_1000_cycle_0 = <0x4c3>;
			iterm_ffc_hot_1000_cycle_0 = <0x54b>;
			iterm_ffc_1000_cycle_1 = <0x363>;
			iterm_ffc_little_warm_1000_cycle_1 = <0x4c5>;
			iterm_ffc_warm_1000_cycle_1 = <0x762>;
			iterm_ffc_hot_1000_cycle_1 = <0x8ba>;
			iterm_ffc_1000_cycle_2 = <0x1ff>;
			iterm_ffc_little_warm_1000_cycle_2 = <0x2f2>;
			iterm_ffc_warm_1000_cycle_2 = <0x4e9>;
			iterm_ffc_hot_1000_cycle_2 = <0x54e>;
			iterm_ffc_1000_cycle_3 = <0x324>;
			iterm_ffc_little_warm_1000_cycle_3 = <0x4e7>;
			iterm_ffc_warm_1000_cycle_3 = <0x774>;
			iterm_ffc_hot_1000_cycle_3 = <0x8d3>;
			step_chg_cfg_1100_cycle = <0xbb8 0xfd2 0x17d4 0xfd3 0x1068 0x12c0 0x1069 0x1130 0x10e0 0x1131 0x11b2 0xe40>;
			step_chg_cfg_1100_cycle_gl = <0xbb8 0xfd2 0x17d4 0xfd3 0x1068 0x12c0 0x1069 0x1130 0x10e0 0x1131 0x11b2 0xc93>;
			step_chg_cfg_1100_cycle_normal = <0xbb8 0x1018 0x17d4 0x1019 0x1158 0x10e0 0x1157 0x1158 0x10e0 0x1157 0x1158 0x10e0>;
			iterm_ffc_1100_cycle_0 = <0x28a>;
			iterm_ffc_little_warm_1100_cycle_0 = <0x363>;
			iterm_ffc_warm_1100_cycle_0 = <0x4c3>;
			iterm_ffc_hot_1100_cycle_0 = <0x54b>;
			iterm_ffc_1100_cycle_1 = <0x399>;
			iterm_ffc_little_warm_1100_cycle_1 = <0x568>;
			iterm_ffc_warm_1100_cycle_1 = <0x762>;
			iterm_ffc_hot_1100_cycle_1 = <0x8ba>;
			iterm_ffc_1100_cycle_2 = <0x25b>;
			iterm_ffc_little_warm_1100_cycle_2 = <0x3bb>;
			iterm_ffc_warm_1100_cycle_2 = <0x4e9>;
			iterm_ffc_hot_1100_cycle_2 = <0x54e>;
			iterm_ffc_1100_cycle_3 = <0x389>;
			iterm_ffc_little_warm_1100_cycle_3 = <0x51a>;
			iterm_ffc_warm_1100_cycle_3 = <0x774>;
			iterm_ffc_hot_1100_cycle_3 = <0x8d3>;
			step_chg_cfg_1200_cycle = <0xbb8 0xfd2 0x17d4 0xfd3 0x1068 0x12c0 0x1069 0x1130 0x10e0 0x1131 0x11b2 0xe40>;
			step_chg_cfg_1200_cycle_gl = <0xbb8 0xfd2 0x17d4 0xfd3 0x1068 0x12c0 0x1069 0x1130 0x10e0 0x1131 0x11b2 0xc93>;
			step_chg_cfg_1200_cycle_normal = <0xbb8 0x1018 0x17d4 0x1019 0x1158 0x10e0 0x1157 0x1158 0x10e0 0x1157 0x1158 0x10e0>;
			iterm_ffc_1200_cycle_0 = <0x2f6>;
			iterm_ffc_little_warm_1200_cycle_0 = <0x43c>;
			iterm_ffc_warm_1200_cycle_0 = <0x4c3>;
			iterm_ffc_hot_1200_cycle_0 = <0x54b>;
			iterm_ffc_1200_cycle_1 = <0x438>;
			iterm_ffc_little_warm_1200_cycle_1 = <0x60a>;
			iterm_ffc_warm_1200_cycle_1 = <0x762>;
			iterm_ffc_hot_1200_cycle_1 = <0x8ba>;
			iterm_ffc_1200_cycle_2 = <0x2f2>;
			iterm_ffc_little_warm_1200_cycle_2 = <0x485>;
			iterm_ffc_warm_1200_cycle_2 = <0x4e9>;
			iterm_ffc_hot_1200_cycle_2 = <0x54e>;
			iterm_ffc_1200_cycle_3 = <0x43e>;
			iterm_ffc_little_warm_1200_cycle_3 = <0x616>;
			iterm_ffc_warm_1200_cycle_3 = <0x774>;
			iterm_ffc_hot_1200_cycle_3 = <0x8d3>;
			thermal_limit_dcp = <0x1f40 0x1e78 0x1db0 0x1ce8 0x1c20 0x1b58 0x1a90 0x19c8 0x1900 0x1838 0x1770 0x16a8 0x15e0 0x1518 0x1450 0x1388 0x12c0 0x11f8 0x1130 0x1068 0xfa0 0xed8 0xe10 0xd48 0xc80 0xbb8 0xaf0 0xa28 0x960 0x898 0x7d0 0x708 0x640 0x578 0x3e8 0x1f4>;
			thermal_limit_qc2 = <0x1f40 0x1e78 0x1db0 0x1ce8 0x1c20 0x1b58 0x1a90 0x19c8 0x1900 0x1838 0x1770 0x16a8 0x15e0 0x1518 0x1450 0x1388 0x12c0 0x11f8 0x1130 0x1068 0xfa0 0xed8 0xe10 0xd48 0xc80 0xbb8 0xaf0 0xa28 0x960 0x898 0x7d0 0x708 0x640 0x578 0x3e8 0x1f4>;
			thermal_limit_qc3_18w = <0x1f40 0x1e78 0x1db0 0x1ce8 0x1c20 0x1b58 0x1a90 0x19c8 0x1900 0x1838 0x1770 0x16a8 0x15e0 0x1518 0x1450 0x1388 0x12c0 0x11f8 0x1130 0x1068 0xfa0 0xed8 0xe10 0xd48 0xc80 0xbb8 0xaf0 0xa28 0x960 0x898 0x7d0 0x708 0x640 0x578 0x3e8 0x1f4>;
			thermal_limit_qc3_27w = <0x1f40 0x1e78 0x1db0 0x1ce8 0x1c20 0x1b58 0x1a90 0x19c8 0x1900 0x1838 0x1770 0x16a8 0x15e0 0x1518 0x1450 0x1388 0x12c0 0x11f8 0x1130 0x1068 0xfa0 0xed8 0xe10 0xd48 0xc80 0xbb8 0xaf0 0xa28 0x960 0x898 0x7d0 0x708 0x640 0x578 0x3e8 0x1f4>;
			thermal_limit_qc35 = <0x1f40 0x1e78 0x1db0 0x1ce8 0x1c20 0x1b58 0x1a90 0x19c8 0x1900 0x1838 0x1770 0x16a8 0x15e0 0x1518 0x1450 0x1388 0x12c0 0x11f8 0x1130 0x1068 0xfa0 0xed8 0xe10 0xd48 0xc80 0xbb8 0xaf0 0xa28 0x960 0x898 0x7d0 0x708 0x640 0x578 0x3e8 0x1f4>;
			thermal_limit_pd = <0x1f40 0x1e78 0x1db0 0x1ce8 0x1c20 0x1b58 0x1a90 0x19c8 0x1900 0x1838 0x1770 0x16a8 0x15e0 0x1518 0x1450 0x1388 0x12c0 0x11f8 0x1130 0x1068 0xfa0 0xed8 0xe10 0xd48 0xc80 0xbb8 0xaf0 0xa28 0x960 0x898 0x7d0 0x708 0x640 0x578 0x3e8 0x1f4>;
			smart_chg_lowfast_thermal = <0x140 0x14a 0x154 0x15e 0x168 0x172 0x17c 0x186 0x18b 0x190 0x19a 0x1a4 0x1a9 0x1ae 0x1b8 0x1c2>;
			smart_chg_lowfast_current = <0x1f40 0x1f40 0x1b58 0x1b58 0x1b58 0x1b58 0x1770 0x1770 0x1770 0x1518 0x11f8 0x11f8 0xe10 0xbb8 0xbb8 0xbb8>;
		};
	};

	fragment@59 {
		target = <0xffffffff>;

		__overlay__ {
			compatible = "pd_cp_manager";
			fv = <0x118c>;
			fv_ffc = <0x11be>;
			max_fcc = <0x1db0>;
			max_vbus = <0x2af8>;
			max_ibus = <0x1004>;
			fcc_low_hyst = <0x96>;
			fcc_high_hyst = <0xffffff9c>;
			low_tbat = <0x64>;
			high_tbat = <0x1e0>;
			high_vbat = <0x1130>;
			high_soc = <0x5f>;
			low_fcc = <0x7d0>;
			cv_vbat = <0x1180>;
			cv_vbat_ffc = <0x119e>;
			cv_ibat = <0x4b0>;
			min_pdo_vbus = <0x1f40>;
			max_pdo_vbus = <0x2af8>;
			switch1_1_enter = <0xa28>;
			switch1_1_exit = <0xe10>;
			switch2_1_enter = <0x1770>;
			switch2_1_exit = <0x1b58>;
			pdm_ibus_gap = <0x258>;
		};
	};

	fragment@60 {
		target = <0xffffffff>;

		__overlay__ {
			tcpc,en_floatgnd;
			wd,wd0_tsleep = <0x01>;
			wd,wd0_tdet = <0x03>;
		};
	};

	fragment@61 {
		target = <0xffffffff>;

		__overlay__ {

			sih_reset_reset {
				phandle = <0x5d>;

				pins_cmd_dat {
					pinmux = <0x2900>;
					drive-strength = <0x02>;
					bias-disable;
					output-low;
				};
			};

			sih_reset_active {
				phandle = <0x5e>;

				pins_cmd_dat {
					pinmux = <0x2900>;
					drive-strength = <0x02>;
					bias-disable;
					output-high;
				};
			};

			sih_interrupt_active {
				phandle = <0x5f>;

				pins_cmd_dat {
					pinmux = <0x900>;
					drive-strength = <0x02>;
					bias-pull-up;
					input-enable;
				};
			};
		};
	};

	fragment@62 {
		target = <0xffffffff>;

		__overlay__ {
			clock-frequency = <0x61a80>;
			status = "ok";

			haptic_hv@5A {
				compatible = "awinic,awinic_haptic";
				reg = <0x5a>;
				irq-gpio = <0xffffffff 0x09 0x00>;
				reset-gpio = <0xffffffff 0x29 0x00>;
				pinctrl-names = "awinic_reset_reset", "awinic_reset_active", "awinic_interrupt_active";
				pinctrl-0 = <0x5a>;
				pinctrl-1 = <0x5b>;
				pinctrl-2 = <0x5c>;
				status = "okay";
				aw86927_vib_mode = <0x00>;
				aw86927_vib_f0_pre = <0x6a4>;
				aw86927_comp_gain_temp = <0xb6>;
				aw86927_vib_f0_cali_percen = <0x07>;
				aw86927_vib_cont_drv1_lvl = <0x7f>;
				aw86927_vib_cont_drv2_lvl = <0x36>;
				aw86927_vib_cont_drv1_time = <0x04>;
				aw86927_vib_cont_drv2_time = <0x06>;
				aw86927_vib_cont_drv_width = <0x6a>;
				aw86927_vib_cont_wait_num = <0x06>;
				aw86927_vib_cont_brk_time = <0x08>;
				aw86927_vib_cont_track_margin = <0x0c>;
				aw86927_vib_brk_bst_md = <0x00>;
				aw86927_vib_cont_tset = <0x06>;
				aw86927_vib_cont_bemf_set = <0x02>;
				aw86927_vib_cont_bst_brk_gain = <0x05>;
				aw86927_vib_cont_brk_gain = <0x08>;
				aw86927_vib_d2s_gain = <0x04>;
				aw86927_vib_trig_config = <0x01 0x00 0x01 0x01 0x01 0x02 0x00 0x00 0x01 0x00 0x00 0x01 0x00 0x02 0x00 0x00 0x01 0x00 0x00 0x01 0x00 0x02 0x00 0x00>;
				aw86927_vib_bst_vol_default = <0x57>;
				aw86927_vib_bst_vol_ram = <0x57>;
				aw86927_vib_bst_vol_rtp = <0x57>;
				vib_effect_id_boundary = <0x0a>;
				vib_effect_max = <0xc5>;
				vib_rtp_time = <0x14 0x14 0x14 0x14 0x14 0x14 0x14 0x14 0x4e20 0x3a98 0x3a98 0x4e20 0x61a8 0x3a98 0x7530 0x61a8 0x4e20 0x4e20 0x4e20 0x4e20 0x4e20 0x4e20 0x4e20 0x4e20 0x4e20 0x4e20 0x4e20 0x4e20 0x4e20 0x4e20 0x4e20 0x4e20 0x4e20 0x4e20 0x4e20 0x4e20 0x4e20 0x4e20 0x4e20 0x4e20 0x4e20 0x4e20 0x4e20 0x4e20 0x4e20 0x4e20 0x4e20 0x4e20 0x4e20 0x4e20 0x4e20 0x4e20 0x4e20 0x4e20 0x4e20 0x4e20 0x4e20 0x4e20 0x4e20 0x4e20 0x4e20 0x4e20 0x4e20 0x4e20 0x4e20 0x4e20 0x4e20 0x4e20 0x4e20 0x4e20 0x4e20 0x4e20 0x4e20 0x4e20 0x4e20 0x4e20 0x4e20 0x4e20 0x4e20 0x4e20 0x4e20 0x4e20 0x4e20 0x4e20 0x4e20 0x4e20 0x4e20 0x4e20 0x4e20 0x4e20 0x4e20 0x4e20 0x4e20 0x4e20 0x4e20 0x4e20 0x4e20 0x4e20 0x4e20 0x4e20 0x4e20 0x4e20 0x4e20 0x4e20 0x4e20 0x4e20 0x4e20 0x4e20 0x4e20 0x4e20 0x4e20 0x4e20 0x4e20 0x4e20 0x4e20 0x4e20 0x4e20 0x4e20 0x4e20 0x4e20 0x4e20 0x4e20 0x4e20 0x4e20 0x4e20 0x4e20 0x4e20 0x4e20 0x4e20 0x4e20 0x4e20 0x4e20 0x4e20 0x4e20 0x4e20 0x4e20 0x4e20 0x4e20 0x4e20 0x4e20 0x4e20 0x4e20 0x4e20 0x4e20 0x4e20 0x4e20 0x4e20 0x4e20 0x4e20 0x4e20 0x4e20 0x4e20 0x4e20 0x4e20 0x4e20 0x4e20 0x4e20 0x4e20 0x4e20 0x4e20 0x4e20 0x4e20 0x4e20 0x4e20 0x4e20 0x4e20 0x4e20 0x4e20 0x4e20 0x4e20 0x4e20 0x4e20 0x4e20 0x4e20 0x4e20>;

				wf_0 {
					mtk,effect-id = <0x00>;
					mtk,wf-vmax-mv = <0xe10>;
					mtk,wf-pattern = [3e 3e];
					mtk,wf-brake-pattern = <0x2010000>;
					mtk,wf-play-rate-us = <0x4e20>;
				};

				wf_1 {
					mtk,effect-id = <0x01>;
					mtk,wf-vmax-mv = <0xe10>;
					mtk,wf-pattern = [7e 3e];
					mtk,wf-brake-pattern = <0x3010000>;
					mtk,wf-play-rate-us = <0x4e20>;
				};

				wf_2 {
					mtk,effect-id = <0x02>;
					mtk,wf-vmax-mv = <0xe10>;
					mtk,wf-pattern = [7e 3e];
					mtk,wf-brake-pattern = <0x2010000>;
					mtk,wf-play-rate-us = <0x4e20>;
				};

				wf_3 {
					mtk,effect-id = <0x03>;
					mtk,wf-vmax-mv = <0xe10>;
					mtk,wf-pattern = [3e 3e];
					mtk,wf-brake-pattern = <0x2010000>;
					mtk,wf-play-rate-us = <0x4e20>;
				};

				wf_4 {
					mtk,effect-id = <0x04>;
					mtk,wf-vmax-mv = <0xe10>;
					mtk,wf-pattern = [3e 3e];
					mtk,wf-brake-pattern = <0x2010000>;
					mtk,wf-play-rate-us = <0x6d60>;
				};

				wf_5 {
					mtk,effect-id = <0x05>;
					mtk,wf-vmax-mv = <0xe10>;
					mtk,wf-pattern = [7e 7e 7e];
					mtk,wf-brake-pattern = <0x3030100>;
					mtk,wf-play-rate-us = <0x4e20>;
				};

				wf_6 {
					mtk,effect-id = <0x06>;
					mtk,wf-vmax-mv = <0xe10>;
					mtk,wf-pattern = [3e 3e];
					mtk,wf-brake-pattern = <0x2010000>;
					mtk,wf-play-rate-us = <0x4e20>;
				};

				wf_7 {
					mtk,effect-id = <0x07>;
					mtk,wf-vmax-mv = <0xe10>;
					mtk,wf-pattern = [3e 3e];
					mtk,wf-brake-pattern = <0x2010000>;
					mtk,wf-play-rate-us = <0x4e20>;
				};

				wf_8 {
					mtk,effect-id = <0x08>;
					mtk,wf-vmax-mv = <0xe10>;
					mtk,wf-pattern = [3e 3e];
					mtk,wf-brake-pattern = <0x2010000>;
					mtk,wf-play-rate-us = <0x4e20>;
				};

				wf_9 {
					mtk,effect-id = <0x09>;
					mtk,wf-vmax-mv = <0xe10>;
					mtk,wf-pattern = [3e 3e];
					mtk,wf-brake-pattern = <0x2010000>;
					mtk,wf-play-rate-us = <0x4e20>;
				};
			};

			sih6887_haptic@6B {
				compatible = "silicon,sih_haptic_688X";
				reg = <0x6b>;
				reset-gpio = <0xffffffff 0x29 0x00>;
				irq-gpio = <0xffffffff 0x09 0x00>;
				interrupt = <0x1a 0x01>;
				pinctrl-names = "sih_reset_reset", "sih_reset_active", "sih_interrupt_active";
				pinctrl-0 = <0x5d>;
				pinctrl-1 = <0x5e>;
				pinctrl-2 = <0x5f>;
				lra_name = "0809";
				vib_effect_id_boundary = <0x0a>;
				vib_effect_max = <0xc5>;
				vib_f0_pre = <0x6a4>;
				vib_bst_vol_default = <0x55>;
				phandle = <0x89>;
			};
		};
	};

	fragment@63 {
		target = <0xffffffff>;

		__overlay__ {

			awinic_reset_reset {
				phandle = <0x5a>;

				pins_cmd_dat {
					pinmux = <0x2900>;
					drive-strength = <0x02>;
					bias-disable;
					output-low;
				};
			};

			awinic_reset_active {
				phandle = <0x5b>;

				pins_cmd_dat {
					pinmux = <0x2900>;
					drive-strength = <0x02>;
					bias-disable;
					output-high;
				};
			};

			awinic_interrupt_active {
				phandle = <0x5c>;

				pins_cmd_dat {
					pinmux = <0x900>;
					drive-strength = <0x02>;
					bias-pull-up;
					input-enable;
				};
			};
		};
	};

	fragment@64 {
		target = <0xffffffff>;

		__overlay__ {
			status = "disabled";
		};
	};

	fragment@65 {
		target = <0xffffffff>;

		__overlay__ {

			w1_pins {
				phandle = <0x60>;

				pins_cmd_dat {
					pinmux = <0x300>;
					drive-strength = <0x07>;
					output-high;
				};
			};
		};
	};

	fragment@66 {
		target = <0xffffffff>;

		__overlay__ {
			compatible = "xiaomi,onewire_gpio";
			gpios = <0xffffffff 0x03 0x00>;
			vfp-supply = <0xffffffff>;
			pinctrl-names = "default";
			pinctrl-0 = <0x60>;
			status = "okay";
		};
	};

	fragment@67 {
		target = <0xffffffff>;

		__overlay__ {
			compatible = "st,stick";
			auth_name = "third_supplier";
			status = "okay";
		};
	};

	fragment@68 {
		target = <0xffffffff>;

		__overlay__ {
			compatible = "maxim,ds28e30";
			auth_name = "second_supplier";
			status = "okay";
		};
	};

	fragment@69 {
		target = <0xffffffff>;

		__overlay__ {
			compatible = "xiaomi,xm-chg-dfs";
			status = "okay";
		};
	};

	fragment@70 {
		target = <0xffffffff>;

		__overlay__ {
			compatible = "acl,slg";
			auth_name = "main_supplier";
			status = "okay";
		};
	};

	fragment@71 {
		target = <0xffffffff>;

		__overlay__ {
			status = "okay";
			clock-frequency = <0x61a80>;

			nxp@28 {
				compatible = "qcom,nq-nci";
				reg = <0x28>;
				qcom,nq-irq = <0xffffffff 0x02 0x00>;
				interrupt-parent = <0xffffffff>;
				interrupts = <0x02 0x04 0x02 0x00>;
				qcom,nq-ven = <0xffffffff 0x28 0x00>;
				qcom,nq-clkreq = <0xffffffff 0x97 0x00>;
				tms,irq-gpio = <0xffffffff 0x02 0x00>;
				tms,ven-gpio = <0xffffffff 0x28 0x00>;
				tms,download-gpio = <0xffffffff 0x27 0x00>;
				interrupt-names = "nfc_irq";
				pinctrl-names = "default", "nfc_active", "nfc_suspend";
				pinctrl-0 = <0x61>;
				pinctrl-1 = <0x62 0x63 0x64 0x65>;
				pinctrl-2 = <0x66 0x67 0x68 0x69>;
			};
		};
	};

	fragment@72 {
		target = <0xffffffff>;

		__overlay__ {

			nfc_default {
				phandle = <0x61>;
			};

			nfc_int_active {
				phandle = <0x62>;

				pins_cmd_dat {
					pinmux = <0x200>;
					slew-rate = <0x00>;
					drive-strength = <0x02>;
					bias-pull-up;
				};
			};

			nfc_int_suspend {
				phandle = <0x66>;

				pins_cmd_dat {
					pinmux = <0x200>;
					slew-rate = <0x00>;
					drive-strength = <0x02>;
					bias-pull-up;
				};
			};

			nfc_enable_active {
				phandle = <0x63>;

				pins_cmd_dat {
					pinmux = <0x2800>;
					slew-rate = <0x01>;
					output-high;
					drive-strength = <0x02>;
					bias-pull-up = <0x67>;
				};
			};

			nfc_enable_suspend {
				phandle = <0x67>;

				pins_cmd_dat {
					pinmux = <0x2800>;
					slew-rate = <0x01>;
					drive-strength = <0x02>;
					bias-disable;
				};
			};

			nfc_firmwaredownload_active {
				phandle = <0x64>;

				pins_cmd_dat {
					pinmux = <0x2700>;
					slew-rate = <0x01>;
					drive-strength = <0x02>;
					bias-pull-up;
				};
			};

			nfc_firmwaredownload_suspend {
				phandle = <0x68>;

				pins_cmd_dat {
					pinmux = <0x2700>;
					slew-rate = <0x01>;
					drive-strength = <0x02>;
					bias-disable;
				};
			};

			nfc_clk_req_active {
				phandle = <0x65>;

				pins_cmd_dat {
					pinmux = <0x9701>;
					slew-rate = <0x00>;
					input-enable;
					drive-strength = <0x02>;
					bias-pull-up;
				};
			};

			nfc_clk_req_suspend {
				phandle = <0x69>;

				pins_cmd_dat {
					pinmux = <0x9701>;
					slew-rate = <0x00>;
					input-enable;
					drive-strength = <0x02>;
					bias-pull-down;
				};
			};
		};
	};

	fragment@73 {
		target = <0xffffffff>;

		__overlay__ {
			#address-cells = <0x01>;
			#size-cells = <0x00>;

			p61@0 {
				compatible = "nxp,p61";
				reg = <0x00>;
				nxp,nfcc = "2-0028";
				spi-max-frequency = <0x7a1200>;
				status = "okay";
				pinctrl-names = "nxp_ese_spi_mode";
				pinctrl-0 = <0x6a>;
			};
		};
	};

	fragment@74 {
		target = <0xffffffff>;

		__overlay__ {

			nxp_ese_spi_mode {
				phandle = <0x6a>;

				pins_cmd_dat {
					pinmux = <0x4b01 0x4a01 0x4801 0x4901>;
					drive-strength = <0x06>;
				};
			};
		};
	};

	fragment@75 {
		target = <0xffffffff>;

		__overlay__ {
			#address-cells = <0x01>;
			#size-cells = <0x00>;

			fingerprint@0 {
				compatible = "xiaomi,xiaomi-fp";
				reg = <0x00>;
				spi-max-frequency = <0x7a1200>;
				netlink-event = <0x1d>;
				vfp-supply = <0xffffffff>;
				power-type = <0x01>;
				pinctrl-names = "spiio_gpio_mode", "spiio_spi_mode", "reset_high", "reset_low", "eint_default", "eint_pulldown";
				pinctrl-0 = <0x6b>;
				pinctrl-1 = <0x6c>;
				pinctrl-2 = <0x6d>;
				pinctrl-3 = <0x6e>;
				pinctrl-4 = <0x6f>;
				pinctrl-5 = <0x70>;
				xiaomi,gpio_irq = <0xffffffff 0x08 0x00>;
				interrupt-parent = <0xffffffff>;
				interrupts = <0x08 0x01 0x08 0x00>;
				status = "okay";
			};
		};
	};

	fragment@76 {
		target = <0xffffffff>;

		__overlay__ {

			state_gpio_mode {
				phandle = <0x6b>;

				pins_cmd_dat {
					pinmux = <0x3800>;
					drive-strength = <0x06>;
					input-enable;
					bias-disable;
				};

				pins_cmd2_dat {
					pinmux = <0x3900>;
					drive-strength = <0x06>;
					input-enable;
					bias-disable;
				};

				pins_cmd3_dat {
					pinmux = <0x3a00>;
					drive-strength = <0x06>;
					input-enable;
					bias-disable;
				};

				pins_cmd4_dat {
					pinmux = <0x3b00>;
					drive-strength = <0x06>;
					input-enable;
					bias-disable;
				};
			};

			state_spi_mode {
				phandle = <0x6c>;

				pins_cmd_dat {
					pinmux = <0x3801>;
					drive-strength = <0x06>;
					input-enable;
					bias-disable;
				};

				pins_cmd2_dat {
					pinmux = <0x3901>;
					drive-strength = <0x06>;
					input-enable;
					bias-disable;
				};

				pins_cmd3_dat {
					pinmux = <0x3a01>;
					drive-strength = <0x06>;
					input-enable;
					bias-disable;
				};

				pins_cmd4_dat {
					pinmux = <0x3b01>;
					drive-strength = <0x06>;
					input-enable;
					bias-disable;
				};
			};

			state_reset_high {
				phandle = <0x6d>;

				pins_cmd_dat {
					pinmux = <0x9b00>;
					slew-rate = <0x01>;
					output-high;
				};
			};

			state_reset_low {
				phandle = <0x6e>;

				pins_cmd_dat {
					pinmux = <0x9b00>;
					slew-rate = <0x01>;
					output-low;
				};
			};

			state_eint_default {
				phandle = <0x6f>;

				pins_cmd_dat {
					pinmux = <0x800>;
					slew-rate = <0x00>;
					input-enable;
					bias-disable;
					input-schmitt-enable;
				};
			};

			state_eint_pulldown {
				phandle = <0x70>;

				pins_cmd_dat {
					pinmux = <0x800>;
					slew-rate = <0x00>;
					input-enable;
					bias-pull-down;
					input-schmitt-enable;
				};
			};
		};
	};

	fragment@77 {
		target = <0xffffffff>;

		__overlay__ {

			xiaomi_wifi_gpio {
				phandle = <0x71>;

				pins_cmd_dat {
					pinmux = <0x2400>;
					drive-strength = <0x02>;
					bias-disable;
					input-enable;
				};
			};
		};
	};

	fragment@78 {
		target = <0xffffffff>;

		__overlay__ {

			xiaomi_wifi_gpio {
				compatible = "wlan,xiaomi_wifi_gpio";
				status-gpio = <0xffffffff 0x24 0x00>;
				debounce-time = <0x1f4>;
				pinctrl-names = "default";
				pinctrl-0 = <0x71>;
			};
		};
	};

	__symbols__ {
		thermal_message = "/fragment@1/__overlay__/thermal-message";
		smartpa_0 = "/fragment@3/__overlay__/aw882xx@35";
		smartpa_1 = "/fragment@3/__overlay__/aw882xx@34";
		sia91xx_i2c_R = "/fragment@3/__overlay__/sia91xx_i2c@R";
		sia91xx_i2c_L = "/fragment@3/__overlay__/sia91xx_i2c@L";
		et7480 = "/fragment@3/__overlay__/et7480@42";
		sia91xx_R = "/fragment@6/__overlay__/sia91xx@R";
		sia91xx_L = "/fragment@6/__overlay__/sia91xx@L";
		sia91xx_gpio_R = "/fragment@8/__overlay__/sia91xx_gpio_R";
		sia91xx_gpio_L = "/fragment@8/__overlay__/sia91xx_gpio_L";
		mtkfb_pins_lcd_bias_enp1 = "/fragment@10/__overlay__/lcd-bias-enp1-gpio";
		mtkfb_pins_lcd_bias_enp0 = "/fragment@10/__overlay__/lcd-bias-enp0-gpio";
		mtkfb_pins_lcd_bias_enn1 = "/fragment@10/__overlay__/lcd-bias-enn1-gpio";
		mtkfb_pins_lcd_bias_enn0 = "/fragment@10/__overlay__/lcd-bias-enn0-gpio";
		mtkfb_pins_lcm_rst_out1_gpio = "/fragment@10/__overlay__/lcm-rst-out1-gpio";
		mtkfb_pins_lcm_rst_out0_gpio = "/fragment@10/__overlay__/lcm-rst-out0-gpio";
		mtkfb_pins_lcm_dsi_te = "/fragment@10/__overlay__/lcm-dsi-te";
		mtkfb_pins_lcm_led_en1 = "/fragment@10/__overlay__/lcm-led-en1-gpio";
		mtkfb_pins_lcm_led_en0 = "/fragment@10/__overlay__/lcm-led-en0-gpio";
		panel_in1 = "/fragment@12/__overlay__/panel1@0/port/endpoint";
		panel_in2 = "/fragment@12/__overlay__/panel2@1/port/endpoint";
		panel_in3 = "/fragment@12/__overlay__/panel3@2/port/endpoint";
		panel_in4 = "/fragment@12/__overlay__/panel4@3/port/endpoint";
		panel_in5 = "/fragment@12/__overlay__/panel5@4/port/endpoint";
		dsi_out = "/fragment@12/__overlay__/ports/port/endpoint";
		dsi_out2 = "/fragment@12/__overlay__/ports/port/endpoint2";
		dsi_out3 = "/fragment@12/__overlay__/ports/port/endpoint3";
		dsi_out4 = "/fragment@12/__overlay__/ports/port/endpoint4";
		dsi_out5 = "/fragment@12/__overlay__/ports/port/endpoint5";
		irtx_gpio_led_default = "/fragment@14/__overlay__/irtx_gpio_led_def@gpio19";
		irtx_gpio_led_set = "/fragment@14/__overlay__/irtx_gpio_led_set@gpio19";
		mtee = "/fragment@17/__overlay__/MTEE";
		svp = "/fragment@17/__overlay__/SecureVideoPath";
		ts_reset_active = "/fragment@37/__overlay__/ts_reset_active";
		ts_int_active = "/fragment@37/__overlay__/ts_int_active";
		ts_int_suspend = "/fragment@37/__overlay__/ts_int_suspend";
		ts_reset_suspend = "/fragment@37/__overlay__/ts_reset_suspend";
		ts_spi_mode = "/fragment@37/__overlay__/ts_spimode";
		seninf_csi_port_0 = "/fragment@38/__overlay__/seninf-csi-port-0";
		seninf_csi_port_0_in = "/fragment@38/__overlay__/seninf-csi-port-0/port/endpoint";
		seninf_csi_port_1 = "/fragment@38/__overlay__/seninf-csi-port-1";
		seninf_csi_port_1_in = "/fragment@38/__overlay__/seninf-csi-port-1/port/endpoint";
		seninf_csi_port_2 = "/fragment@38/__overlay__/seninf-csi-port-2";
		seninf_csi_port_2_in = "/fragment@38/__overlay__/seninf-csi-port-2/port/endpoint";
		seninf_csi_port_3 = "/fragment@38/__overlay__/seninf-csi-port-3";
		seninf_csi_port_3_in = "/fragment@38/__overlay__/seninf-csi-port-3/port/endpoint";
		camera_wide_avdd = "/fragment@39/__overlay__/camera-wide-avdd";
		camera_wide_dvdd = "/fragment@39/__overlay__/camera-wide-dvdd";
		camera_uw_f_macro_avdd = "/fragment@39/__overlay__/camera-uw-f-macro-avdd";
		et5904_pm = "/fragment@40/__overlay__/etek,ldo@50";
		et5904_l1 = "/fragment@40/__overlay__/etek,ldo@50/on,et5904@0";
		et5904_l2 = "/fragment@40/__overlay__/etek,ldo@50/on,et5904@1";
		et5904_l3 = "/fragment@40/__overlay__/etek,ldo@50/on,et5904@2";
		et5904_l4 = "/fragment@40/__overlay__/etek,ldo@50/on,et5904@3";
		camera_pins_cam0_mclk_off = "/fragment@41/__overlay__/camera-pins-cam0-mclk-off";
		camera_pins_cam0_mclk_2ma = "/fragment@41/__overlay__/camera-pins-cam0-mclk-2ma";
		camera_pins_cam0_mclk_4ma = "/fragment@41/__overlay__/camera-pins-cam0-mclk-4ma";
		camera_pins_cam0_mclk_6ma = "/fragment@41/__overlay__/camera-pins-cam0-mclk-6ma";
		camera_pins_cam0_mclk_8ma = "/fragment@41/__overlay__/camera-pins-cam0-mclk-8ma";
		camera_pins_cam0_rst_0 = "/fragment@41/__overlay__/cam0@0";
		camera_pins_cam0_rst_1 = "/fragment@41/__overlay__/cam0@1";
		camera_pins_cam1_mclk_off = "/fragment@41/__overlay__/camera-pins-cam1-mclk-off";
		camera_pins_cam1_mclk_2ma = "/fragment@41/__overlay__/camera-pins-cam1-mclk-2ma";
		camera_pins_cam1_mclk_4ma = "/fragment@41/__overlay__/camera-pins-cam1-mclk-4ma";
		camera_pins_cam1_mclk_6ma = "/fragment@41/__overlay__/camera-pins-cam1-mclk-6ma";
		camera_pins_cam1_mclk_8ma = "/fragment@41/__overlay__/camera-pins-cam1-mclk-8ma";
		camera_pins_cam1_rst_0 = "/fragment@41/__overlay__/cam1@0";
		camera_pins_cam1_rst_1 = "/fragment@41/__overlay__/cam1@1";
		camera_pins_cam2_mclk_off = "/fragment@41/__overlay__/camera-pins-cam2-mclk-off";
		camera_pins_cam2_mclk_2ma = "/fragment@41/__overlay__/camera-pins-cam2-mclk-2ma";
		camera_pins_cam2_mclk_4ma = "/fragment@41/__overlay__/camera-pins-cam2-mclk-4ma";
		camera_pins_cam2_mclk_6ma = "/fragment@41/__overlay__/camera-pins-cam2-mclk-6ma";
		camera_pins_cam2_mclk_8ma = "/fragment@41/__overlay__/camera-pins-cam2-mclk-8ma";
		camera_pins_cam2_rst_0 = "/fragment@41/__overlay__/cam2@0";
		camera_pins_cam2_rst_1 = "/fragment@41/__overlay__/cam2@1";
		camera_pins_cam3_mclk_off = "/fragment@41/__overlay__/camera-pins-cam3-mclk-off";
		camera_pins_cam3_mclk_2ma = "/fragment@41/__overlay__/camera-pins-cam3-mclk-2ma";
		camera_pins_cam3_mclk_4ma = "/fragment@41/__overlay__/camera-pins-cam3-mclk-4ma";
		camera_pins_cam3_mclk_6ma = "/fragment@41/__overlay__/camera-pins-cam3-mclk-6ma";
		camera_pins_cam3_mclk_8ma = "/fragment@41/__overlay__/camera-pins-cam3-mclk-8ma";
		camera_pins_cam3_rst_0 = "/fragment@41/__overlay__/cam3@0";
		camera_pins_cam3_rst_1 = "/fragment@41/__overlay__/cam3@1";
		camera_pins_default = "/fragment@41/__overlay__/camdefault";
		mtk_camera_eeprom0 = "/fragment@42/__overlay__/camera-eeprom0@51";
		main_af = "/fragment@42/__overlay__/camera-af-main@a/port/endpoint";
		sensor0 = "/fragment@42/__overlay__/sensor0@10";
		sensor0_out = "/fragment@42/__overlay__/sensor0@10/port/endpoint";
		main_af_endpoint = "/fragment@43/__overlay__/port@0/endpoint";
		sensor2 = "/fragment@44/__overlay__/sensor2@1A";
		sensor2_out = "/fragment@44/__overlay__/sensor2@1A/port/endpoint";
		mtk_camera_eeprom2 = "/fragment@44/__overlay__/camera-eeprom2@50";
		sensor3 = "/fragment@44/__overlay__/sensor3@3C";
		sensor3_out = "/fragment@44/__overlay__/sensor3@3C/port/endpoint";
		mtk_camera_eeprom3 = "/fragment@44/__overlay__/camera-eeprom3@52";
		sensor1 = "/fragment@45/__overlay__/sensor1@10";
		sensor1_out = "/fragment@45/__overlay__/sensor1@10/port/endpoint";
		mtk_camera_eeprom1 = "/fragment@45/__overlay__/camera-eeprom1@51";
		camera0 = "/fragment@46/__overlay__/camera0";
		camera0_crit = "/fragment@46/__overlay__/camera0/trips/camera0-crit";
		camera1 = "/fragment@46/__overlay__/camera1";
		camera1_crit = "/fragment@46/__overlay__/camera1/trips/camera1-crit";
		camera2 = "/fragment@46/__overlay__/camera2";
		camera2_crit = "/fragment@46/__overlay__/camera2/trips/camera2-crit";
		camera3 = "/fragment@46/__overlay__/camera3";
		camera3_crit = "/fragment@46/__overlay__/camera3/trips/camera3-crit";
		flashlight_pins_default = "/fragment@48/__overlay__/flashlightdefault";
		flashlight_pins_en_output1 = "/fragment@48/__overlay__/flashlightenoutput1";
		flashlight_pins_en_output0 = "/fragment@48/__overlay__/flashlightenoutput0";
		flashlight_pins_sel_flash = "/fragment@48/__overlay__/flashlightselflash";
		flashlight_pins_sel_torch = "/fragment@48/__overlay__/flashlightseltorch";
		sc8541_standalone = "/fragment@51/__overlay__/sc8541@6A";
		bq25960_standalone = "/fragment@51/__overlay__/bq25960@65";
		sih_reset_low = "/fragment@61/__overlay__/sih_reset_reset";
		sih_reset_high = "/fragment@61/__overlay__/sih_reset_active";
		sih_interrupt = "/fragment@61/__overlay__/sih_interrupt_active";
		sih6887_haptic = "/fragment@62/__overlay__/sih6887_haptic@6B";
		awinic_reset_low = "/fragment@63/__overlay__/awinic_reset_reset";
		awinic_reset_high = "/fragment@63/__overlay__/awinic_reset_active";
		awinic_interrupt = "/fragment@63/__overlay__/awinic_interrupt_active";
		w1_pins = "/fragment@65/__overlay__/w1_pins";
		nfc_default = "/fragment@72/__overlay__/nfc_default";
		nfc_int_active = "/fragment@72/__overlay__/nfc_int_active";
		nfc_int_suspend = "/fragment@72/__overlay__/nfc_int_suspend";
		nfc_enable_active = "/fragment@72/__overlay__/nfc_enable_active";
		nfc_enable_suspend = "/fragment@72/__overlay__/nfc_enable_suspend";
		nfc_firmwaredownload_active = "/fragment@72/__overlay__/nfc_firmwaredownload_active";
		nfc_firmwaredownload_suspend = "/fragment@72/__overlay__/nfc_firmwaredownload_suspend";
		nfc_clk_req_active = "/fragment@72/__overlay__/nfc_clk_req_active";
		nfc_clk_req_suspend = "/fragment@72/__overlay__/nfc_clk_req_suspend";
		nxp_ese_spi_mode = "/fragment@74/__overlay__/nxp_ese_spi_mode";
		fingerprints_spiio_gpio_mode = "/fragment@76/__overlay__/state_gpio_mode";
		fingerprints_spiio_spi_mode = "/fragment@76/__overlay__/state_spi_mode";
		fingerprints_reset_high = "/fragment@76/__overlay__/state_reset_high";
		fingerprints_reset_low = "/fragment@76/__overlay__/state_reset_low";
		fingerprints_eint_default = "/fragment@76/__overlay__/state_eint_default";
		fingerprints_eint_pulldown = "/fragment@76/__overlay__/state_eint_pulldown";
		xiaomi_wifi_gpio = "/fragment@77/__overlay__/xiaomi_wifi_gpio";
	};

	__fixups__ {
		chosen = "/fragment@0:target:0";
		odm = "/fragment@1:target:0", "/fragment@6:target:0", "/fragment@39:target:0", "/fragment@78:target:0";
		pdc = "/fragment@2:target:0", "/fragment@54:target:0";
		i2c6 = "/fragment@3:target:0", "/fragment@40:target:0";
		pio = "/fragment@3/__overlay__/aw882xx@35:reset-gpio:0", "/fragment@3/__overlay__/aw882xx@35:irq-gpio:0", "/fragment@3/__overlay__/aw882xx@35:fsm,rst-gpio:0", "/fragment@3/__overlay__/aw882xx@35:fsm,irq-gpio:0", "/fragment@3/__overlay__/aw882xx@34:reset-gpio:0", "/fragment@3/__overlay__/aw882xx@34:irq-gpio:0", "/fragment@3/__overlay__/aw882xx@34:fsm,rst-gpio:0", "/fragment@3/__overlay__/aw882xx@34:fsm,irq-gpio:0", "/fragment@6/__overlay__/sia91xx@R:si,si_pa_irq:0", "/fragment@6/__overlay__/sia91xx@R:si,si_pa_reset:0", "/fragment@6/__overlay__/sia91xx@L:si,si_pa_irq:0", "/fragment@6/__overlay__/sia91xx@L:si,si_pa_reset:0", "/fragment@8:target:0", "/fragment@10:target:0", "/fragment@12/__overlay__/panel1@0:reset-gpios:0", "/fragment@12/__overlay__/panel1@0:dvdd-gpios:0", "/fragment@12/__overlay__/panel2@1:reset-gpios:0", "/fragment@12/__overlay__/panel2@1:dvdd-gpios:0", "/fragment@12/__overlay__/panel3@2:reset-gpios:0", "/fragment@12/__overlay__/panel3@2:dvdd-gpios:0", "/fragment@12/__overlay__/panel4@3:reset-gpios:0", "/fragment@12/__overlay__/panel4@3:dvdd-gpios:0", "/fragment@12/__overlay__/panel5@4:reset-gpios:0", "/fragment@12/__overlay__/panel5@4:dvdd-gpios:0", "/fragment@14:target:0", "/fragment@22/__overlay__:GPIO-FDD-BAND-SUPPORT-DETECT-1ST-PIN:0", "/fragment@22/__overlay__:GPIO-SIM1-HOT-PLUG:0", "/fragment@22/__overlay__:GPIO-SIM2-HOT-PLUG:0", "/fragment@22/__overlay__:GPIO-SIM1-SCLK:0", "/fragment@22/__overlay__:GPIO-SIM1-SRST:0", "/fragment@22/__overlay__:GPIO-SIM1-SIO:0", "/fragment@22/__overlay__:GPIO-SIM2-SCLK:0", "/fragment@22/__overlay__:GPIO-SIM2-SRST:0", "/fragment@22/__overlay__:GPIO-SIM2-SIO:0", "/fragment@24/__overlay__:interrupt-parent:0", "/fragment@25/__overlay__:interrupt-parent:0", "/fragment@26/__overlay__:interrupt-parent:0", "/fragment@26/__overlay__:deb-gpios:0", "/fragment@27/__overlay__:interrupt-parent:0", "/fragment@28/__overlay__:interrupt-parent:0", "/fragment@29/__overlay__:interrupt-parent:0", "/fragment@29/__overlay__:deb-gpios:0", "/fragment@30/__overlay__:interrupt-parent:0", "/fragment@31/__overlay__:interrupt-parent:0", "/fragment@32/__overlay__:interrupt-parent:0", "/fragment@34/__overlay__/gdx-cli@0:focaltech,irq-gpio:0", "/fragment@34/__overlay__/gdx-cli@0:focaltech,reset-gpio:0", "/fragment@34/__overlay__/gdx-cli@0:goodix,reset-gpio:0", "/fragment@34/__overlay__/gdx-cli@0:goodix,irq-gpio:0", "/fragment@37:target:0", "/fragment@39/__overlay__/camera-wide-avdd:gpio:0", "/fragment@39/__overlay__/camera-wide-dvdd:gpio:0", "/fragment@39/__overlay__/camera-uw-f-macro-avdd:gpio:0", "/fragment@40/__overlay__/etek,ldo@50:BoardId_gpio1:0", "/fragment@40/__overlay__/etek,ldo@50:BoardId_gpio2:0", "/fragment@40/__overlay__/etek,ldo@50:BoardId_gpio3:0", "/fragment@41:target:0", "/fragment@42/__overlay__/sensor0@10:BoardId_gpio1:0", "/fragment@42/__overlay__/sensor0@10:BoardId_gpio2:0", "/fragment@42/__overlay__/sensor0@10:BoardId_gpio3:0", "/fragment@48:target:0", "/fragment@50/__overlay__/epa-elna-mtk/hwid:gpio:0", "/fragment@50/__overlay__/epa-elna-mtk/hwid:gpio:12", "/fragment@50/__overlay__/epa-elna-mtk/hwid:gpio:24", "/fragment@51/__overlay__/sc8541@6A:interrupt-parent:0", "/fragment@51/__overlay__/sc8541@6A:sc8541,intr_gpio:0", "/fragment@51/__overlay__/bq25960@65:bq25960,intr_gpio:0", "/fragment@61:target:0", "/fragment@62/__overlay__/haptic_hv@5A:irq-gpio:0", "/fragment@62/__overlay__/haptic_hv@5A:reset-gpio:0", "/fragment@62/__overlay__/sih6887_haptic@6B:reset-gpio:0", "/fragment@62/__overlay__/sih6887_haptic@6B:irq-gpio:0", "/fragment@63:target:0", "/fragment@65:target:0", "/fragment@66/__overlay__:gpios:0", "/fragment@71/__overlay__/nxp@28:qcom,nq-irq:0", "/fragment@71/__overlay__/nxp@28:interrupt-parent:0", "/fragment@71/__overlay__/nxp@28:qcom,nq-ven:0", "/fragment@71/__overlay__/nxp@28:qcom,nq-clkreq:0", "/fragment@71/__overlay__/nxp@28:tms,irq-gpio:0", "/fragment@71/__overlay__/nxp@28:tms,ven-gpio:0", "/fragment@71/__overlay__/nxp@28:tms,download-gpio:0", "/fragment@72:target:0", "/fragment@74:target:0", "/fragment@75/__overlay__/fingerprint@0:xiaomi,gpio_irq:0", "/fragment@75/__overlay__/fingerprint@0:interrupt-parent:0", "/fragment@76:target:0", "/fragment@77:target:0", "/fragment@78/__overlay__/xiaomi_wifi_gpio:status-gpio:0";
		accdet = "/fragment@4:target:0";
		sound = "/fragment@5:target:0", "/fragment@7:target:0";
		mtkfb = "/fragment@9:target:0";
		dispsys_config = "/fragment@11:target:0";
		dsi0 = "/fragment@12:target:0";
		mt6369_vmch = "/fragment@12/__overlay__/panel1@0:amoled-vci-supply:0", "/fragment@12/__overlay__/panel2@1:amoled-vci-supply:0", "/fragment@12/__overlay__/panel3@2:amoled-vci-supply:0", "/fragment@12/__overlay__/panel4@3:amoled-vci-supply:0", "/fragment@12/__overlay__/panel5@4:amoled-vci-supply:0";
		mt6369_vmc = "/fragment@12/__overlay__/panel1@0:amoled-vio18-supply:0", "/fragment@12/__overlay__/panel2@1:amoled-vio18-supply:0", "/fragment@12/__overlay__/panel3@2:amoled-vio18-supply:0", "/fragment@12/__overlay__/panel4@3:amoled-vio18-supply:0", "/fragment@12/__overlay__/panel5@4:amoled-vio18-supply:0";
		irtx_pwm = "/fragment@13:target:0";
		audio_sram = "/fragment@15:target:0";
		audio_xhci_sram = "/fragment@16:target:0";
		mtee_svp = "/fragment@17:target:0";
		mtkheap_page_svp = "/fragment@18:target:0";
		mtkheap_page_wfd = "/fragment@19:target:0";
		mtkheap_region_svp = "/fragment@20:target:0";
		mtkheap_region_wfd = "/fragment@21:target:0";
		gpio_usage_mapping = "/fragment@22:target:0";
		gpio = "/fragment@23:target:0";
		nfc = "/fragment@24:target:0";
		touch = "/fragment@25:target:0";
		mrdump_ext_rst = "/fragment@26:target:0";
		subpmic_pmu_eint = "/fragment@27:target:0";
		rt5133_eint = "/fragment@28:target:0";
		swtp = "/fragment@29:target:0";
		smart_pa = "/fragment@30:target:0";
		dsi_te = "/fragment@31:target:0";
		md1_sim1_hot_plug_eint = "/fragment@32:target:0";
		keypad = "/fragment@33:target:0";
		spi3 = "/fragment@34:target:0";
		mt6369_vibr = "/fragment@34/__overlay__/gdx-cli@0:iovdd-supply:0", "/fragment@35:target:0";
		mt6369_vtp = "/fragment@34/__overlay__/gdx-cli@0:avdd-supply:0", "/fragment@36:target:0";
		seninf_top = "/fragment@38:target:0";
		csi_efuse0 = "/fragment@38/__overlay__/seninf-csi-port-0:nvmem-cells:0";
		csi_efuse1 = "/fragment@38/__overlay__/seninf-csi-port-1:nvmem-cells:0";
		csi_efuse2 = "/fragment@38/__overlay__/seninf-csi-port-2:nvmem-cells:0";
		csi_efuse3 = "/fragment@38/__overlay__/seninf-csi-port-3:nvmem-cells:0";
		i2c8 = "/fragment@42:target:0";
		mt6363_vio18 = "/fragment@42/__overlay__/sensor0@10:dovdd-supply:0", "/fragment@44/__overlay__/sensor2@1A:dovdd-supply:0", "/fragment@44/__overlay__/sensor3@3C:dovdd-supply:0", "/fragment@45/__overlay__/sensor1@10:dovdd-supply:0";
		topckgen_clk = "/fragment@42/__overlay__/sensor0@10:clocks:0", "/fragment@42/__overlay__/sensor0@10:clocks:8", "/fragment@42/__overlay__/sensor0@10:clocks:16", "/fragment@42/__overlay__/sensor0@10:clocks:24", "/fragment@42/__overlay__/sensor0@10:clocks:32", "/fragment@42/__overlay__/sensor0@10:clocks:40", "/fragment@42/__overlay__/sensor0@10:clocks:48", "/fragment@42/__overlay__/sensor0@10:clocks:56", "/fragment@44/__overlay__/sensor2@1A:clocks:0", "/fragment@44/__overlay__/sensor2@1A:clocks:8", "/fragment@44/__overlay__/sensor2@1A:clocks:16", "/fragment@44/__overlay__/sensor2@1A:clocks:24", "/fragment@44/__overlay__/sensor2@1A:clocks:32", "/fragment@44/__overlay__/sensor2@1A:clocks:40", "/fragment@44/__overlay__/sensor2@1A:clocks:48", "/fragment@44/__overlay__/sensor2@1A:clocks:56", "/fragment@44/__overlay__/sensor3@3C:clocks:0", "/fragment@44/__overlay__/sensor3@3C:clocks:8", "/fragment@44/__overlay__/sensor3@3C:clocks:16", "/fragment@44/__overlay__/sensor3@3C:clocks:24", "/fragment@44/__overlay__/sensor3@3C:clocks:32", "/fragment@44/__overlay__/sensor3@3C:clocks:40", "/fragment@44/__overlay__/sensor3@3C:clocks:48", "/fragment@44/__overlay__/sensor3@3C:clocks:56", "/fragment@45/__overlay__/sensor1@10:clocks:0", "/fragment@45/__overlay__/sensor1@10:clocks:8", "/fragment@45/__overlay__/sensor1@10:clocks:16", "/fragment@45/__overlay__/sensor1@10:clocks:24", "/fragment@45/__overlay__/sensor1@10:clocks:32", "/fragment@45/__overlay__/sensor1@10:clocks:40", "/fragment@45/__overlay__/sensor1@10:clocks:48", "/fragment@45/__overlay__/sensor1@10:clocks:56";
		mtk_composite_v4l2_2 = "/fragment@43:target:0";
		i2c7 = "/fragment@44:target:0";
		i2c4 = "/fragment@45:target:0";
		thermal_zones = "/fragment@46:target:0";
		flashlights_led191 = "/fragment@47:target:0";
		mitee = "/fragment@49:target:0";
		connfem = "/fragment@50:target:0";
		nofem = "/fragment@50/__overlay__/epa-elna-mtk:parts:0", "/fragment@50/__overlay__/epa-elna-mtk:parts:4", "/fragment@50/__overlay__/epa-elna-mtk:parts:8", "/fragment@50/__overlay__/epa-elna-mtk:parts:12", "/fragment@50/__overlay__/epa-elna-mtk:parts:16", "/fragment@50/__overlay__/epa-elna-mtk:parts:20";
		mxd7751s = "/fragment@50/__overlay__/epa-elna-mtk:parts:24", "/fragment@50/__overlay__/epa-elna-mtk:parts:28";
		sky85320 = "/fragment@50/__overlay__/epa-elna-mtk:parts:32", "/fragment@50/__overlay__/epa-elna-mtk:parts:40";
		sky85720 = "/fragment@50/__overlay__/epa-elna-mtk:parts:36", "/fragment@50/__overlay__/epa-elna-mtk:parts:44";
		qm42195 = "/fragment@50/__overlay__/epa-elna-mtk:parts:48";
		qm45197 = "/fragment@50/__overlay__/epa-elna-mtk:parts:52";
		wlan7207h = "/fragment@50/__overlay__/epa-elna-mtk:parts:56";
		wlan7207c = "/fragment@50/__overlay__/epa-elna-mtk:parts:60";
		i2c3 = "/fragment@51:target:0";
		pe = "/fragment@52:target:0";
		pe2 = "/fragment@53:target:0";
		pe45 = "/fragment@55:target:0";
		pe5 = "/fragment@56:target:0";
		pe5p = "/fragment@57:target:0";
		charger = "/fragment@58:target:0";
		pd_cp_manager = "/fragment@59:target:0";
		mt6375_typec = "/fragment@60:target:0";
		i2c12 = "/fragment@62:target:0";
		regulator_vibrator = "/fragment@64:target:0";
		onewire_gpio = "/fragment@66:target:0";
		mt6369_vfp = "/fragment@66/__overlay__:vfp-supply:0", "/fragment@75/__overlay__/fingerprint@0:vfp-supply:0";
		st_stick = "/fragment@67:target:0";
		maxim_ds28e16 = "/fragment@68:target:0";
		xm_chg_dfs = "/fragment@69:target:0";
		acl_slg = "/fragment@70:target:0";
		i2c2 = "/fragment@71:target:0";
		spi5 = "/fragment@73:target:0";
		spi0 = "/fragment@75:target:0";
	};

	__local_fixups__ {

		fragment@3 {

			__overlay__ {

				sia91xx_i2c@R {
					si,sipa-dev = <0x00>;
				};

				sia91xx_i2c@L {
					si,sipa-dev = <0x00>;
				};
			};
		};

		fragment@4 {

			__overlay__ {
				et7480-i2c-handle = <0x00>;
			};
		};

		fragment@5 {

			__overlay__ {

				mediatek,speaker-codec {
					sound-dai = <0x00 0x04>;
				};

				mediatek,speaker-codec-fsm {
					sound-dai = <0x00>;
				};

				mediatek,speaker-codec-sia {
					sound-dai = <0x00 0x04>;
				};
			};
		};

		fragment@6 {

			__overlay__ {

				sia91xx@R {
					pinctrl-0 = <0x00>;
				};

				sia91xx@L {
					pinctrl-0 = <0x00>;
				};
			};
		};

		fragment@7 {

			__overlay__ {
				si,sia81xx-aux-devs = <0x00 0x04>;
			};
		};

		fragment@9 {

			__overlay__ {
				pinctrl-0 = <0x00>;
				pinctrl-1 = <0x00>;
				pinctrl-2 = <0x00>;
				pinctrl-3 = <0x00>;
				pinctrl-4 = <0x00>;
				pinctrl-5 = <0x00>;
				pinctrl-6 = <0x00>;
				pinctrl-7 = <0x00>;
				pinctrl-8 = <0x00>;
			};
		};

		fragment@11 {

			__overlay__ {
				pinctrl-0 = <0x00>;
			};
		};

		fragment@12 {

			__overlay__ {

				panel1@0 {

					port {

						endpoint {
							remote-endpoint = <0x00>;
						};
					};
				};

				panel2@1 {

					port {

						endpoint {
							remote-endpoint = <0x00>;
						};
					};
				};

				panel3@2 {

					port {

						endpoint {
							remote-endpoint = <0x00>;
						};
					};
				};

				panel4@3 {

					port {

						endpoint {
							remote-endpoint = <0x00>;
						};
					};
				};

				panel5@4 {

					port {

						endpoint {
							remote-endpoint = <0x00>;
						};
					};
				};

				ports {

					port {

						endpoint {
							remote-endpoint = <0x00>;
						};

						endpoint2 {
							remote-endpoint = <0x00>;
						};

						endpoint3 {
							remote-endpoint = <0x00>;
						};

						endpoint4 {
							remote-endpoint = <0x00>;
						};

						endpoint5 {
							remote-endpoint = <0x00>;
						};
					};
				};
			};
		};

		fragment@13 {

			__overlay__ {
				pinctrl-0 = <0x00>;
				pinctrl-1 = <0x00>;
			};
		};

		fragment@34 {

			__overlay__ {

				gdx-cli@0 {
					pinctrl-0 = <0x00 0x04>;
					pinctrl-1 = <0x00 0x04>;
					pinctrl-2 = <0x00>;
				};
			};
		};

		fragment@38 {

			__overlay__ {

				seninf-csi-port-0 {

					port {

						endpoint {
							remote-endpoint = <0x00>;
						};
					};
				};

				seninf-csi-port-1 {

					port {

						endpoint {
							remote-endpoint = <0x00>;
						};
					};
				};

				seninf-csi-port-2 {

					port {

						endpoint {
							remote-endpoint = <0x00>;
						};
					};
				};

				seninf-csi-port-3 {

					port {

						endpoint {
							remote-endpoint = <0x00>;
						};
					};
				};
			};
		};

		fragment@42 {

			__overlay__ {

				camera-af-main@a {
					vin-supply = <0x00>;

					port {

						endpoint {
							remote-endpoint = <0x00>;
						};
					};
				};

				sensor0@10 {
					pinctrl-0 = <0x00>;
					pinctrl-1 = <0x00>;
					pinctrl-2 = <0x00>;
					pinctrl-3 = <0x00>;
					pinctrl-4 = <0x00>;
					pinctrl-5 = <0x00>;
					pinctrl-6 = <0x00>;
					avdd-supply = <0x00>;
					dvdd-supply = <0x00>;
					dvdd1-supply = <0x00>;
					afvdd-supply = <0x00>;
					avdd1-supply = <0x00>;

					port {

						endpoint {
							remote-endpoint = <0x00>;
						};
					};
				};
			};
		};

		fragment@43 {

			__overlay__ {

				port@0 {

					endpoint {
						remote-endpoint = <0x00>;
					};
				};
			};
		};

		fragment@44 {

			__overlay__ {

				sensor2@1A {
					pinctrl-0 = <0x00>;
					pinctrl-1 = <0x00>;
					pinctrl-2 = <0x00>;
					pinctrl-3 = <0x00>;
					pinctrl-4 = <0x00>;
					pinctrl-5 = <0x00>;
					pinctrl-6 = <0x00>;
					avdd-supply = <0x00>;
					dvdd-supply = <0x00>;

					port {

						endpoint {
							remote-endpoint = <0x00>;
						};
					};
				};

				sensor3@3C {
					pinctrl-0 = <0x00>;
					pinctrl-1 = <0x00>;
					pinctrl-2 = <0x00>;
					pinctrl-3 = <0x00>;
					pinctrl-4 = <0x00>;
					pinctrl-5 = <0x00>;
					pinctrl-6 = <0x00>;
					avdd-supply = <0x00>;

					port {

						endpoint {
							remote-endpoint = <0x00>;
						};
					};
				};
			};
		};

		fragment@45 {

			__overlay__ {

				sensor1@10 {
					pinctrl-0 = <0x00>;
					pinctrl-1 = <0x00>;
					pinctrl-2 = <0x00>;
					pinctrl-3 = <0x00>;
					pinctrl-4 = <0x00>;
					pinctrl-5 = <0x00>;
					pinctrl-6 = <0x00>;
					avdd-supply = <0x00>;
					dvdd-supply = <0x00>;

					port {

						endpoint {
							remote-endpoint = <0x00>;
						};
					};
				};
			};
		};

		fragment@46 {

			__overlay__ {

				camera0 {
					thermal-sensors = <0x00>;
				};

				camera1 {
					thermal-sensors = <0x00>;
				};

				camera2 {
					thermal-sensors = <0x00>;
				};

				camera3 {
					thermal-sensors = <0x00>;
				};
			};
		};

		fragment@47 {

			__overlay__ {
				pinctrl-0 = <0x00>;
				pinctrl-1 = <0x00>;
				pinctrl-2 = <0x00>;
				pinctrl-3 = <0x00>;
				pinctrl-4 = <0x00>;
			};
		};

		fragment@62 {

			__overlay__ {

				haptic_hv@5A {
					pinctrl-0 = <0x00>;
					pinctrl-1 = <0x00>;
					pinctrl-2 = <0x00>;
				};

				sih6887_haptic@6B {
					pinctrl-0 = <0x00>;
					pinctrl-1 = <0x00>;
					pinctrl-2 = <0x00>;
				};
			};
		};

		fragment@66 {

			__overlay__ {
				pinctrl-0 = <0x00>;
			};
		};

		fragment@71 {

			__overlay__ {

				nxp@28 {
					pinctrl-0 = <0x00>;
					pinctrl-1 = <0x00 0x04 0x08 0x0c>;
					pinctrl-2 = <0x00 0x04 0x08 0x0c>;
				};
			};
		};

		fragment@73 {

			__overlay__ {

				p61@0 {
					pinctrl-0 = <0x00>;
				};
			};
		};

		fragment@75 {

			__overlay__ {

				fingerprint@0 {
					pinctrl-0 = <0x00>;
					pinctrl-1 = <0x00>;
					pinctrl-2 = <0x00>;
					pinctrl-3 = <0x00>;
					pinctrl-4 = <0x00>;
					pinctrl-5 = <0x00>;
				};
			};
		};

		fragment@78 {

			__overlay__ {

				xiaomi_wifi_gpio {
					pinctrl-0 = <0x00>;
				};
			};
		};
	};
};
